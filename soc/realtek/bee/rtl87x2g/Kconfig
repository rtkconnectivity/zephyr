## soc/realtek/bee/rtl87x2g/Kconfig
```kconfig
# Copyright (c) 2024 Realtek Semiconductor Corp.
# SPDX-License-Identifier: Apache-2.0
config SOC_SERIES_RTL87X2G
	select ARM
	select CPU_CORTEX_M55
	select CPU_HAS_ARM_SAU
	select CPU_HAS_FPU
	select CPU_HAS_ARM_MPU
	select DYNAMIC_INTERRUPTS
	select ARMV8_M_DSP
	select ARMV8_1_M_MVEI
	select ARMV8_1_M_MVEF
	select ARM_TRUSTZONE_M
	select XIP
	select HAS_PM
	select THREAD_STACK_INFO
```

## soc/realtek/bee/rtl87x2g/Kconfig.defconfig.rtl8762gn
```kconfig
# Copyright (c) 2024 Realtek Semiconductor Corp.
# SPDX-License-Identifier: Apache-2.0
if SOC_RTL8762GN

config SOC
	default "rtl8762gn"

endif # SOC_RTL8762GN
```

## soc/realtek/bee/rtl87x2g/Kconfig.defconfig.series
```kconfig
# Copyright (c) 2024 Realtek Semiconductor Corp.
# SPDX-License-Identifier: Apache-2.0
if SOC_SERIES_RTL87X2G
config SOC_SERIES
	default "rtl87x2g"

config SOC_PART_NUMBER
	default "rtl8762gku" if SOC_PART_NUMBER_RTL8762GKU
	default "rtl8762gkh" if SOC_PART_NUMBER_RTL8762GKH
	default "rtl8762gn" if SOC_PART_NUMBER_RTL8762GN
	default "rtl8762gtp" if SOC_PART_NUMBER_RTL8762GTP
	default "rtl8762gtu" if SOC_PART_NUMBER_RTL8762GTU
	default "rtl8762gth" if SOC_PART_NUMBER_RTL8762GTH
	default "rtl8772gwf" if SOC_PART_NUMBER_RTL8772GWF
	default "rtl8772gwp" if SOC_PART_NUMBER_RTL8772GWP
	default "rtl8777g" if SOC_PART_NUMBER_RTL8777G

config NUM_IRQS
	int
	default 109

config CODE_DATA_RELOCATION
	default y

config USE_DT_CODE_PARTITION
	default y

config FPU
	default y if CPU_HAS_FPU

config SYS_CLOCK_HW_CYCLES_PER_SEC
	int
	default 32000

config SYS_CLOCK_TICKS_PER_SEC
	int
	default 100
    #10ms/1tick

config ARCH_HAS_CUSTOM_BUSY_WAIT
	default y

endif # SOC_SERIES_RTL87X2G
```

## soc/realtek/bee/rtl87x2g/Kconfig.soc
```kconfig
# Copyright (c) 2024 Realtek Semiconductor Corp.
# SPDX-License-Identifier: Apache-2.0
config SOC_SERIES_RTL87X2G
	bool
	select SOC_FAMILY_REALTEK_BEE
	help
	  Enable support for Realtek RTL87x2G series

config SOC_RTL8762GKU
	bool
	select SOC_SERIES_RTL87X2G

config SOC_RTL8762GKH
	bool
	select SOC_SERIES_RTL87X2G

config SOC_RTL8762GN
	bool
	select SOC_SERIES_RTL87X2G

config SOC_RTL8762GTP
	bool
	select SOC_SERIES_RTL87X2G

config SOC_RTL8762GTU
	bool
	select SOC_SERIES_RTL87X2G

config SOC_RTL8762GTH
	bool
	select SOC_SERIES_RTL87X2G

config SOC_RTL8772GWF
	bool
	select SOC_SERIES_RTL87X2G

config SOC_RTL8772GWP
	bool
	select SOC_SERIES_RTL87X2G

config SOC_RTL8777G
	bool
	select SOC_SERIES_RTL87X2G

config SOC
	default "rtl8762gkh" if SOC_RTL8762GKH
	default "rtl8762gku" if SOC_RTL8762GKU
	default "rtl8762gn" if SOC_RTL8762GN
	default "rtl8762gth" if SOC_RTL8762GTH
	default "rtl8762gtp" if SOC_RTL8762GTP
	default "rtl8762gtu" if SOC_RTL8762GTU
	default "rtl8772gwf" if SOC_RTL8772GWF
	default "rtl8772gwp" if SOC_RTL8772GWP
	default "rtl8777g" if SOC_RTL8777G

if SOC_SERIES_RTL87X2G

config SOC_PART_NUMBER_RTL8762GKU
	bool
config SOC_PART_NUMBER_RTL8762GKH
	bool
config SOC_PART_NUMBER_RTL8762GN
	bool
config SOC_PART_NUMBER_RTL8762GTP
	bool
config SOC_PART_NUMBER_RTL8762GTU
	bool
config SOC_PART_NUMBER_RTL8762GTH
	bool
config SOC_PART_NUMBER_RTL8772GWF
	bool
config SOC_PART_NUMBER_RTL8772GWP
	bool
config SOC_PART_NUMBER_RTL8777G
	bool

endif
```

## tests/boards/rtl8762gn_evb/pm/btmac_wakeup/testcase.yaml
```yaml
tests:
  boards.rtl87x2g.pm.btmac_wakeup:
    platform_allow:
      - rtl8762gn_evb
    tags:
      - pm
      - bluetooth
```

## tests/boards/rtl8762gn_evb/pm/pad_wakeup_powerdown/testcase.yaml
```yaml
tests:
  boards.rtl87x2g.pm.pad_wakeup_powerdown:
    platform_allow:
      - rtl8762gn_evb
    tags:
      - pm
```

## tests/boards/rtl8762gn_evb/pm/timeout_wakeup/testcase.yaml
```yaml
tests:
  boards.rtl87x2g.pm.timeout_wakeup:
    platform_allow:
      - rtl8762gn_evb
    tags:
      - pm
```

## tests/drivers/rtc/rtc_api/boards/rtl8752htv_evb.conf
```kconfig
# Copyright(c) 2020, Realtek Semiconductor Corporation.
# SPDX-License-Identifier: Apache-2.0

CONFIG_RTC_RTL8752H=y
CONFIG_RTC_ALARM=y
CONFIG_RTC_UPDATE=y
```
