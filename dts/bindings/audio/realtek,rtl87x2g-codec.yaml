## dts/bindings/audio/realtek,rtl87x2g-codec.yaml
```yaml
# Copyright(c) 2025, Realtek Semiconductor Corporation.
# SPDX-License-Identifier: Apache-2.0

description: |
  RTL87X2G CODEC.

compatible: "realtek,rtl87x2g-codec"

include: [i2s-device.yaml, pinctrl-device.yaml]

properties:
  channel-sequence:
    type: string
    description: |
      Specify the I2S Tx/Rx channel sequence.
    enum:
      - "l_r"
      - "r_l"
      - "l_l"
      - "r_r"

  mic-bias:
    type: string
    description: |
      Specify the MICBIAS voltage.
    enum:
      - "1_507"
      - "1_62"
      - "1_705"
      - "1_8"
      - "1_906"
      - "2_025"
      - "2_16"
      - "2_314"

  mic-bst-gain:
    type: string
    description: |
      Specify the MICBST gain.
    enum:
      - "0dB"
      - "20dB"
      - "30dB"
      - "40dB"

  mic-bst-mode:
    type: string
    description: |
      Specify the MICBST mode.
    enum:
      - "single"
      - "differential"

  mic-type:
    type: string
    description: |
      Specify the channel 0/1 mic type, which can be dmic or amic.
    enum:
      - "amic"
      - "dmic"

  dmic-data-latch:
    type: string
    description: |
      Specify the channel 0/1 dmic data latch type.
    enum:
      - "falling_latch"
      - "rising_latch"

  ad-gain:
    type: int
    description: |
      Specify the channel 0/1 ADC digital volume.
      0x2F - 0dB, step 0.375dB, range -17.625dB ~ 30dB

  boost-gain:
    type: string
    description: |
      Specify the channel 0/1 boost gain.
    enum:
      - "0dB"
      - "12dB"
      - "24dB"
      - "36dB"

  da-gain:
    type: int
    description: |
      Specify the DAC gain control.
      0x0 - 0xAF
```

## dts/bindings/counter/realtek,bee_rtc.yaml
```yaml
# Copyright(c) 2026, Realtek Semiconductor Corporation.
# SPDX-License-Identifier: Apache-2.0

description: |
  Bee COUNTER RTC.

  From the above, setting 'status' is required while the prescaler is
  optional. Check below for more information on the prescaler.

compatible: "realtek,bee-rtc"

include: [base.yaml, rtc-device.yaml]

properties:
  reg:
    required: true

  interrupts:
    required: true

  channels:
    required: true
    type:
      int

  src-clk-freq:
    type: int
    description: |
      Frequency of rtc source clock. Default is 32000, can be 32768 if use external crystal.
    enum:
      - 32000
      - 32768

  prescaler:
    description: |
      The prescaler value defines the factor by which the clock will be
      divided. The outcome of which serves as clock reference to the Timer
      itself.

    type: int
    default: 1
```

## dts/bindings/counter/realtek,bee_timer.yaml
```yaml
# Copyright(c) 2026, Realtek Semiconductor Corporation.
# SPDX-License-Identifier: Apache-2.0

description: |
        Bee COUNTER TIMER.
        Each Timer is part of a Timer Group and the number of available Timers
        is SoC-dependent.
        RTL87X2G has 12 Timers available, 8 normal timer and 4 advanced timer.
        RTL8752H has 6 Timers available, 4 normal timer and 2 advanced timer.

        In order to use one of the available timers on your application add
        a <board>.overlay file with contents as below

          &timer2 {
                  status = "okay";
                  prescaler = <1>;
          };

        From the above, setting 'status' is required while the prescaler is
        optional. Check below for more information on the prescaler.

compatible: "realtek,bee-timer"

include: base.yaml

properties:
  reg:
    required: true

  interrupts:
    required: true

  clocks:
    required: true

  channels:
    required: true
    type:
      int

  is-enhanced:
    type:
      boolean

  prescaler:
    description: |
      The prescaler value defines the factor by which the clock will be
      divided.
      RTL87X2G supports 1/2/4/8/16/32/40/64.
      RTL8752H supports 1/2/4/8/40/125.

    type: int
    default: 1
    enum:
      - 1
      - 2
      - 4
      - 8
      - 16
      - 32
      - 40
      - 64
      - 125
```

## dts/bindings/flash_controller/realtek,bee-eflash-controller.yaml
```yaml
# SPDX-License-Identifier: Apache-2.0
#
# Copyright (c) 2026 Realtek Semiconductor Corporation
#

description: Realtek Bee eflash controller

compatible: "realtek,bee-eflash-controller"

include: flash-controller.yaml
```

## dts/bindings/gpio/realtek,bee-gpio.yaml
```yaml
# Copyright(c) 2025, Realtek Semiconductor Corporation.
# SPDX-License-Identifier: Apache-2.0

description: |
  BEE GPIO.
  Note that some of different pins could be mapped to the same gpio number.

  For RTL8762GTU and RTL8762GTH,
  P6_2 and P9_0 are both mapped to gpiob_21,
  P6_3 and P9_1 are both mapped to gpiob_22,
  P6_5 and P9_3 are both mapped to gpiob_24,
  P6_7 and P9_5 are both mapped to gpiob_26.
  P9_0 and P9_1 could be configured as qdec pin and any other pinmux.
  So if users want to use qdec with P9_0 and P9_1, users should avoid configuring
  P9_0, P9_1 as gpio, and should use P6_2, P6_3 as gpiob_21, gpiob_22.

  For RTL8752H,
  P4_1 and P3_5 are both mapped to gpiob_29,
  P4_2 and P3_6 are both mapped to gpiob_30.

compatible: "realtek,bee-gpio"

include: [gpio-controller.yaml, base.yaml]

properties:
  reg:
    required: true

  clocks:
    required: true

  "#gpio-cells":
    const: 2

  port:
    type: int
    required: true
    description: |
      The GPIO port number.
      GPIO port GPIOA has:

        port = <0>;

      And GPIO port GPIOB has:

        port = <1>;

gpio-cells:
  - pin
  - flags
```

## dts/bindings/i2c/realtek,bee-i2c.yaml
```yaml
# Copyright(c) 2025, Realtek Semiconductor Corporation.
# SPDX-License-Identifier: Apache-2.0

description: |
  BEE I2C.

compatible: "realtek,bee-i2c"

include: [i2c-controller.yaml, reset-device.yaml, pinctrl-device.yaml]

properties:
  reg:
    required: true

  interrupts:
    required: true

  clocks:
    required: true

  pinctrl-0:
    required: true

  pinctrl-names:
    required: true
```

## dts/bindings/i2s/realtek,bee-i2s.yaml
```yaml
# Copyright(c) 2026, Realtek Semiconductor Corporation.
# SPDX-License-Identifier: Apache-2.0

description: |
  Bee I2S.

compatible: "realtek,bee-i2s"

include: [i2s-controller.yaml, pinctrl-device.yaml]

properties:
  reg:
    required: true

  interrupts:
    required: true

  dma-names:
    required: true
```

## dts/bindings/i2s/realtek,rtl8752h-i2s.yaml
```yaml
# Copyright(c) 2024, Realtek Semiconductor Corporation.
# SPDX-License-Identifier: Apache-2.0

description: |
  RTL8752H I2S.

compatible: "realtek,rtl8752h-i2s"

include: [i2s-controller.yaml, pinctrl-device.yaml]

properties:
  reg:
    required: true

  interrupts:
    required: true

  dma-names:
    required: true
```

## dts/bindings/i2s/realtek,rtl87x2g-i2s.yaml
```yaml
# Copyright(c) 2025, Realtek Semiconductor Corporation.
# SPDX-License-Identifier: Apache-2.0

description: |
  RTL87X2G I2S.

compatible: "realtek,rtl87x2g-i2s"

include: [i2s-controller.yaml, pinctrl-device.yaml]

properties:
  reg:
    required: true

  interrupts:
    required: true

  dma-names:
    required: true
```

## dts/bindings/ieee802154/realtek,bee-ieee802154.yaml
```yaml
description: Realtek bee IEEE 802.15.4 node

compatible: "realtek,bee-ieee802154"

include: base.yaml
```

## dts/bindings/ir/realtek,bee-ir.yaml
```yaml
# Copyright(c) 2026, Realtek Semiconductor Corporation.
# SPDX-License-Identifier: Apache-2.0

description: |
  Realtek Bee series IR (infrared) controller.

  The controller drives / captures the raw carrier on a single IR line and is
  half-duplex: the same peripheral is time-shared between transmit (TX) and
  receive (RX). It supports both a interrupt path and a DMA data path,
  selected per direction by whether a DMA channel is wired up (see "dmas"
  below).

  Configuration overview
  -----------------------

  Pin control (required):
    Two pinctrl states must be provided via "pinctrl-names":
      - "ir-tx" : applied on tx enable (IRDA_TX driven output).
      - "ir-rx" : applied on rx enable (IRDA_RX input, typically pull-up).
    The driver switches between them automatically on tx/rx enable. There is no
    "default" state: the driver never applies one at init (pinctrl state IDs are
    matched by name, not by index, so "ir-tx" may be pinctrl-0).

  DMA (optional, per direction):
    Add a "dmas" entry named "tx" and/or "rx". Whichever names are present
    enable the DMA data path for that direction; a direction with no DMA entry
    falls back to the interrupt/FIFO path. Both can be enabled independently.

  RX trigger edge (optional):
    See "rx-falling-edge-trig".

  Example:

      &dma0 {
          status = "okay";
      };

      &ir {
          pinctrl-0 = <&ir_tx>;
          pinctrl-1 = <&ir_rx>;
          pinctrl-names = "ir-tx", "ir-rx";

          /* Optional: enable DMA for TX and RX. Omit an entry to use the
           * interrupt/FIFO path for that direction instead.
           */
          dmas = <&dma0 0 27 0x26a1>, <&dma0 0 28 0x268a>;
          dma-names = "tx", "rx";

          status = "okay";
      };

compatible: "realtek,bee-ir"

include: [base.yaml, pinctrl-device.yaml]

bus: ir

properties:
  reg:
    required: true

  clocks:
    required: true

  interrupts:
    required: true

  pinctrl-0:
    required: true

  pinctrl-names:
    required: true
    description: |
      Names of the pinctrl states. Must include "ir-tx" and "ir-rx":
        - "ir-tx": applied automatically on tx enable.
        - "ir-rx": applied automatically on rx enable.
      No "default" state is used.

  dmas:
    description: |
      Optional TX and/or RX DMA channel specifiers. Use "dma-names" to tag them
      "tx" and/or "rx". A direction is driven by DMA only when its name is
      present here; otherwise the interrupt/FIFO path is used for that
      direction.

  dma-names:
    description: |
      Names for the "dmas" entries. Valid names are "tx" and "rx".

  rx-falling-edge-trig:
    type: boolean
    description: |
      Select the RX capture trigger edge. When present, RX is triggered on the
      falling edge (and the level-counter threshold counts the high level).
      When absent (default), RX is triggered on the rising edge (and the
      counter counts the low level).
```

## dts/bindings/ir/realtek,rtl8752h-ir.yaml
```yaml
# Copyright(c) 2024, Realtek Semiconductor Corporation.
# SPDX-License-Identifier: Apache-2.0

description: |
  RTL8752H IR.

compatible: "realtek,rtl8752h-ir"

include: [base.yaml, pinctrl-device.yaml]

bus: ir

properties:
  reg:
    required: true

  clocks:
    required: true

  interrupts:
    required: true

  pinctrl-0:
    required: true

  pinctrl-names:
    required: true
```

## dts/bindings/mtd/realtek,bee-eflash.yaml
```yaml
# Copyright (c) 2026 Realtek Semiconductor Corporation
# SPDX-License-Identifier: Apache-2.0

description: Realtek Bee eflash

compatible: "realtek,bee-eflash"

include: soc-nv-flash.yaml
```

## dts/bindings/pinctrl/realtek,bee-pinctrl.yaml
```yaml
# Copyright(c) 2026, Realtek Semiconductor Corporation.
# SPDX-License-Identifier: Apache-2.0

description: |
  Bee pin controller.
  The bee pin controller is a singleton node responsible for controlling
  pin function selection and pin properties. For example, you can use this
  node to route UART2 TX to pin P3_2 and enable the pull-up resistor on the
  pin.

  The node has the 'pinctrl' node label set in your SoC's devicetree,
  so you can modify it like this:

    &pinctrl {
            /* your modifications go here */
    };

  All device pin configurations should be placed in child nodes of the
  'pinctrl' node, as shown in this example:

    /* You can put this in places like a board-pinctrl.dtsi file in
     * your board directory, or a devicetree overlay in your application.
     */
    &pinctrl {
      /* configuration for uart2 device, default state */
      uart2_default: uart2_default {
        /* group 1 ('group1' name is arbitrary) */
        group1 {
          /* configure P3_2 as UART_TX and P3_3 as UART_RX */
          psels = <BEE_PSEL(UART2_TX, P3_2, DIR_OUT, DRV_HIGH, PULL_UP)>,
                  <BEE_PSEL(UART2_RX, P3_3, DIR_IN, DRV_HIGH, PULL_UP)>;
        };
      };
    };

  The 'uart2_default' child node encodes the pin configurations for a
  particular state of a device; in this case, the default (that is, active)
  state. You would specify the low-power configuration for the same device
  in a separate child node.

  As shown, pin configurations are organized in groups within each child node.
  Each group can specify a list of pin function selections in the 'psels'
  property. The BEE_PSEL macro is used to specify a pin function selection
  and pin configuration. You could choose pinmux specified function to
  specified pin. And you could configure driver direction, driver state and
  pull state for the specified pad. Available pin functions and configurations
  can be found in the include\zephyr\dt-bindings\pinctrl\bee-pinctrl.h
  header file.

  To link this pin configuration with a device, use a pinctrl-N property
  for some number N, like this example you could place in your board's DTS
  file:

     #include "rtlxxxx_evb-pinctrl.dtsi"

     &uart2 {
           pinctrl-0 = <&uart2_default>;
           pinctrl-names = "default";
     };

compatible: "realtek,bee-pinctrl"

include: base.yaml

child-binding:
  description: |
    Bee pin controller pin configuration state nodes.
  child-binding:
    description: |
      Realtek Bee pin controller pin configuration group.

    properties:
      psels:
        required: true
        type: array
        description: |
          Pinmux function number and pad configurations.

      bias-pull-strong:
        type: boolean
        description: enable pull-strong resistor

      wakeup-high:
        type: boolean
        description: enable wakeup high function

      wakeup-low:
        type: boolean
        description: enable wakeup low function

      current-level:
        type: int
        description: |
          current level of pin
          when VDDIO is set to 1.8V, the pad driving current is as followed:
              level0: 1.25 mA
              level1: 2.50 mA
              level2: 3.75 mA
              level3: 5.00 mA
          When VDDIO is set to 3.3V, the pad driving current is as followed:
              level0: 4 mA
              level1: 8 mA
              level2: 12 mA
              level3: 16 mA
        enum:
          - 0
          - 1
          - 2
          - 3
```

## dts/bindings/pwm/realtek,bee-lppwm.yaml
```yaml
# Copyright (c) 2026, Realtek Semiconductor Corporation
# SPDX-License-Identifier: Apache-2.0

description: |
  Realtek Bee always-on low-power PWM (LPPWM).

  The LPPWM lives in the always-on (AON) domain and keeps running
  while the SoC is in a low-power sleep state.

compatible: "realtek,bee-lppwm"

include: [base.yaml, pwm-controller.yaml, pinctrl-device.yaml]

properties:
  reg:
    required: true

  clocks:
    type: phandle-array
    required: true

  pinctrl-0:
    required: true

  pinctrl-names:
    required: true

  "#pwm-cells":
    const: 3

pwm-cells:
  - channel
  - period
  - flags
```
