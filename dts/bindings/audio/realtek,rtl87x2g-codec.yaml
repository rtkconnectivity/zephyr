## dts/bindings/pwm/realtek,bee-pwm.yaml
```yaml
# Copyright (c) 2026, Realtek Semiconductor Corporation
# SPDX-License-Identifier: Apache-2.0

description: Realtek Bee Timer implemented as PWM

compatible: "realtek,bee-pwm"

include: [base.yaml, pwm-controller.yaml, pinctrl-device.yaml]

properties:
  clocks:
    type: phandle-array

  pinctrl-0:
    required: true

  pinctrl-names:
    required: true

  "#pwm-cells":
    const: 3

  start-polarity:
    type: string
    enum:
      - "high"
      - "low"
    description: |
      Output level at the start of each PWM period. The pulse width is
      kept either way, so this only shifts the phase of the waveform.
      Only supported on RTL87X2J, where the SoC devicetree sets it to
      "low"; must not be set on other series.

  output-mode:
    type: string
    default: "push-pull"
    enum:
      - "push-pull"
      - "open-drain"
    description: |
      PWM output driver mode. With "open-drain" the high level comes
      from an external pull-up.
      Only supported on RTL87X2J; other series must keep the default.

pwm-cells:
  - channel
  - period
  - flags
```

## dts/bindings/sdhc/realtek,bee-sdhc.yaml
```yaml
# Copyright(c) 2026, Realtek Semiconductor Corporation.
# SPDX-License-Identifier: Apache-2.0

description: |
  Bee SDHC controller.

compatible: "realtek,bee-sdhc"

include: [sdhc.yaml, base.yaml, pinctrl-device.yaml]

properties:
  reg:
    required: true

  interrupts:
    required: true

  pinctrl-0:
    required: true

  pinctrl-names:
    required: true

  bus-width:
    type: int
    enum:
      - 1
      - 4
    default: 4
    description: SD bus width in bits

  pin-group:
    type: int
    enum:
      - 0
      - 1
    required: true
    description: pin group for sdhc

  pwr-gpios:
    type: phandle-array
    description: |
      Power pin
      This is a configurable pin to deliver power supply to the SD card.
      It is configured as a GPIO in order to execute power toggles and
      reinitialize the SD slave when necessary.

  int-gpios:
    type: phandle-array
    description: |
      Interrupt pin
      This gpio is used generate interrupt with sdio card in 4bit mode.
      It's not necessary in 1bit mode.
      This gpio should be configured to the same pin as D1 line.
```

## dts/bindings/sensor/realtek,bee-aon_qdec.yaml
```yaml
# Copyright(c) 2026, Realtek Semiconductor Corporation.
# SPDX-License-Identifier: Apache-2.0

description: |
  Bee AON_QDEC.

compatible: "realtek,bee-aon_qdec"

include: [sensor-device.yaml, pinctrl-device.yaml]

properties:
  reg:
    required: true

  interrupts:
    required: true

  pinctrl-0:
    required: true

  x-counts-per-revolution:
    type: int
    default: 4
    description: |
      This is a number that is used to determine how many revolutions
      were done based on the current counter's value.
    enum:
      - 2
      - 4

  x-debounce-time-ms:
    type: int
    default: 4
    description: |
      Set the debounce time of x axis. The unit is ms.
```

## dts/bindings/sensor/realtek,bee-lpqdec.yaml
```yaml
# Copyright (c) 2026, Realtek Semiconductor Corporation
# SPDX-License-Identifier: Apache-2.0

description: |
  Bee LPQDEC.
  This QDEC only supports the X-axis.

compatible: "realtek,bee-lpqdec"

include: [sensor-device.yaml, pinctrl-device.yaml, "realtek,bee-qdec.yaml"]
```

## dts/bindings/sensor/realtek,bee-qdec.yaml
```yaml
# Copyright(c) 2026, Realtek Semiconductor Corporation.
# SPDX-License-Identifier: Apache-2.0

description: |
  Bee QDEC

compatible: "realtek,bee-qdec"

include: [sensor-device.yaml, pinctrl-device.yaml]

properties:
  reg:
    required: true

  clocks:
    required: true

  interrupts:
    required: true

  pinctrl-0:
    required: true

  x-counts-per-revolution:
    type: int
    default: 4
    description: |
      This is a number that is used to determine how many revolutions
      were done based on the current counter's value.
    enum:
      - 2
      - 4

  y-counts-per-revolution:
    type: int
    default: 4
    description: |
      This is a number that is used to determine how many revolutions
      were done based on the current counter's value.
    enum:
      - 2
      - 4

  z-counts-per-revolution:
    type: int
    default: 4
    description: |
      This is a number that is used to determine how many revolutions
      were done based on the current counter's value.
    enum:
      - 2
      - 4

  x-debounce-time-ms:
    type: int
    default: 4
    description: |
      Set the debounce time of x axis. The unit is ms.

  y-debounce-time-ms:
    type: int
    default: 4
    description: |
      Set the debounce time of x axis. The unit is ms.

  z-debounce-time-ms:
    type: int
    default: 4
    description: |
      Set the debounce time of x axis. The unit is ms.
```

## dts/bindings/serial/realtek,bee-uart.yaml
```yaml
# Copyright(c) 2025, Realtek Semiconductor Corporation.
# SPDX-License-Identifier: Apache-2.0

description: |
  Bee UART.

compatible: "realtek,bee-uart"

include: [uart-controller.yaml, base.yaml, pinctrl-device.yaml]

bus: uart

properties:
  reg:
    required: true

  clocks:
    required: true

  interrupts:
    required: true

  pinctrl-0:
    required: true

  pinctrl-names:
    required: true

  flow-ctrl:
    type: boolean
    description: |
      Enable cts and rts or not.
```

## dts/bindings/timer/cortex-m-systick.yaml
```yaml
# Copyright (c) 2023 MUNIC SA
# SPDX-License-Identifier: Apache-2.0

# Common fields for SysTick of ARM Cortex-M chips
include: base.yaml

properties:
  reg:
    required: true

  external-clock-source:
    type: boolean
    description: |
      For ARM Cortex-M SysTick timer, the CLKSOURCE bit in the
      SysTick Control and Status Register (CSR) selects the clock source.
      If this property is present, the external reference clock is selected.
      If absent, the processor/core clock is selected.

  min-delay:
    type: int
    default: 1024
    description: |
      Minimum delay in cycles for the SysTick timer. This controls the
      minimum timeout value that can be set. For low-frequency clock
      sources (e.g., 32kHz), the default 1024 cycles may be too large,
      causing minimum timeout of 32ms or more. Set this to a lower value
      (e.g., equal to CYC_PER_TICK) to allow shorter timeouts.
      The effective minimum delay is the maximum of this value and
      (CYC_PER_TICK / 16).
```

## dts/bindings/timer/realtek,grtc-timer.yaml
```yaml
# Copyright(c) 2026, Realtek Semiconductor Corporation.
# SPDX-License-Identifier: Apache-2.0

description: Realtek GRTC timer

compatible: "realtek,grtc-timer"

include: base.yaml

properties:
  channel:
    type: int
    required: true
    enum:
      - 0
      - 1
      - 2
      - 3

  reg:
    required: true

  interrupts:
    required: true
```

## dts/bindings/usb/realtek,bee-udc.yaml
```yaml
# Copyright(c) 2025, Realtek Semiconductor Corporation.
# SPDX-License-Identifier: Apache-2.0

description: |
  BEE USB device controller.

compatible: "realtek,bee-udc"

include: ["snps,dwc2.yaml", pinctrl-device.yaml]

properties:
  reg:
    required: true

  interrupts:
    required: true
```

## dts/bindings/watchdog/realtek,rtl8752h-core-wdt.yaml
```yaml
description: RealTek core watchdog timer

compatible: "realtek,rtl8752h-core-wdt"

include: base.yaml

properties:
  reg:
    required: true

  # 16Bit: 32.768k/(1+divfactor).
  div-factor:
    type: int
    description: Watchdog clock divider
    required: true

  initial-timeout-ms:
    type: int
    default: 4000
    description: |
      Set timeout value in milliseconds.
```
