## dts/bindings/gpio/realtek,rtl87x2g-gpio.yaml
```yaml
# Copyright(c) 2020, Realtek Semiconductor Corporation.
# SPDX-License-Identifier: Apache-2.0

description: |
  RTL87X2G GPIO.
  The relationship between pin and gpio number for different part number is shown below.
  
  Note that for RTL8762GTU, different pin could be mapped to the same gpio number, which means
  P6_2 and P9_0 are both mapped to gpiob_21, P6_3 and P9_1 are both mapped to gpiob_22,
  P6_5 and P9_3 are both mapped to gpiob_24, P6_7 and P9_5 are both mapped to gpiob_26.
  For RTL8762GTU, P9_0 and P9_1 could be configured as qcode pin and any other pinmux.
  So to use gpio easier, users should avoid configuring P9_0, P9_1, P9_3 and P9_5 as gpio.
  If users want to use gpiob_21, gpiob_22, gpiob_24, gpiob_26, you should use P6_2, P6_3, 
  P6_5 and P6_7.

                        (RTL8762GRU/   (RTL8777G)   (RTL8762GKU)  (RTL8762GK)  (RTL8762GN)  (RTL8762GTP)  (RTL8762GTU)  (RTL8772GWP)  (RTL8772GWF)
                         RTL8762GRH)
  P0_0    GPIOA_0                                                     1             1             1            1            1             1
  P0_1    GPIOA_1                          1                          1             1             1            1            1             1
  P0_2    GPIOA_2                          1                          1             1             1            1            1             1
  P0_3    GPIOA_3             1            1            1             1             1             1            1            1             1
  P0_4    GPIOA_4                                       1             1             1             1            1            1             1
  P0_5    GPIOA_5                          1            1             1             1             1            1            1             1
  P0_6    GPIOA_6                                       1                           1             1            1            1             1
  P0_7    GPIOA_7                                                                   1             1                         1             1
  P1_0    GPIOA_8             1            1            1             1             1             1            1            1             1
  P1_1    GPIOA_9             1            1            1             1             1             1            1            1             1
  P1_2    GPIOA_10                                      1                           1             1            1            1             1
  P1_3    GPIOA_11                                                                                1                         1             1
  P1_4    GPIOA_12                                                                                1                         1             1
  P1_5    GPIOA_13                                                                  1             1            1            1             1
  P1_6    GPIOA_14                                                                  1             1                         1             1
  P1_7    GPIOA_15                                                                  1             1            1            1             1
  P2_0    GPIOA_21                         1                          1             1                                                     1
  P2_1    GPIOA_22                         1                          1             1                                                     1
  P2_2    GPIOA_23                         1                          1             1                          1            1             1
  P2_3    GPIOA_24                         1            1             1             1             1            1            1             1
  P2_4    GPIOA_25            1            1            1             1             1             1            1            1             1
  P2_5    GPIOA_26            1            1            1             1             1             1            1            1             1
  P2_6    GPIOA_27            1            1            1             1             1             1            1            1             1
  P2_7    GPIOA_28            1            1            1             1             1             1            1            1             1
  P3_0    GPIOA_29            1            1            1             1             1             1            1            1             1
  P3_1    GPIOA_30            1            1            1             1             1             1            1            1             1
  P3_2    GPIOA_31            1            1            1             1             1             1            1            1             1
  P3_3    GPIOB_0                          1            1             1             1             1            1            1             1
  P3_4    GPIOB_1                          1            1             1             1             1            1            1             1
  P3_5    GPIOB_2                          1            1             1             1             1            1            1             1
  P3_6    GPIOB_3                          1            1                           1             1            1            1             1
  P3_7    GPIOB_4                                                                                              1            1             1
  P4_0    GPIOB_5             1            1            1             1             1             1            1            1             1
  P4_1    GPIOB_6             1            1            1             1             1             1            1            1             1
  P4_2    GPIOB_7                          1            1             1             1             1            1            1             1
  P4_3    GPIOB_8                          1            1             1             1             1            1            1             1
  P4_4    GPIOB_9                                                                                                           1             1
  P4_5    GPIOB_10                                                                                                          1             1
  P4_6    GPIOB_11                                                                                                          1             1
  P4_7    GPIOB_12                                                                                                          1             1
  P5_0    GPIOB_13                                                                                                          1             1
  P5_1    GPIOB_14                                                                                                          1             1
  P5_2    GPIOB_15                                                                                                          1             1
  P5_3    GPIOB_16                                                                                                          1             1
  P5_4    GPIOB_17                                                                                                          1             1
  P5_5    GPIOB_18                                                                                                          1             1
  P5_6    GPIOB_19                                      1
  P5_7    GPIOB_20                                      1                                         1
  P6_0    GPIOB_19
  P6_1    GPIOB_20                                                                                             1
  P6_2    GPIOB_21                                                                                             1
  P6_3    GPIOB_22                                                                                             1
  P6_4    GPIOB_23                                                                                             1
  P6_5    GPIOB_24                                                                                             1
  P6_6    GPIOB_25
  P6_7    GPIOB_26                                                                                             1                          1
  P7_0    GPIOB_27                                                                                                                        1
  P7_1    GPIOB_28                                                                                                                        1
  P7_2    GPIOB_29                                                                                                                        1
  P7_3    GPIOB_30                                                                                                                        1
  P7_4    GPIOB_31                                                                                                                        1
  MICBIAS GPIOA_16                         1                          1             1             1            1            1             1
  XI32K   GPIOA_17            1            1            1             1             1             1            1            1             1
  XO32K   GPIOA_18            1            1            1             1             1             1            1            1             1
  DACP    GPIOA_19
  DACN    GPIOA_20
  P9_0    GPIOB_21                         1            1                                         1            1            1             1
  P9_1    GPIOB_22                         1            1                                         1            1            1             1
  P9_2    GPIOB_23                                                                                1                         1             1
  P9_3    GPIOB_24                                                                                1            1            1
  P9_4    GPIOB_25                                                                                1            1            1
  P9_5    GPIOB_26                                                                                1            1            1
  P9_6    GPIOB_27                                                                                1            1            1
  P9_7    GPIOB_28                                                                                1            1            1
  10_0    GPIOB_29                                                                                1            1            1
  10_1    GPIOB_30                                                                                                          1
  10_2    GPIOB_31                                                                                                          1

compatible: "realtek,rtl87x2g-gpio"

include: [gpio-controller.yaml, base.yaml]

properties:
  reg:
    required: true

  clocks:
    required: true

  "#gpio-cells":
    const: 2

  port:
    type: int
    required: true
    description: |
      The GPIO port number. 
      GPIO port GPIOA has:

        port = <0>;

      And GPIO port GPIOB has:

        port = <1>;

gpio-cells:
  - pin
  - flags
```

## dts/bindings/i2c/realtek,rtl8752h-i2c.yaml
```yaml
# Copyright(c) 2024, Realtek Semiconductor Corporation.
# SPDX-License-Identifier: Apache-2.0

description: |
  RTL8752H I2C.

compatible: "realtek,rtl8752h-i2c"

include: [i2c-controller.yaml, reset-device.yaml, pinctrl-device.yaml]

properties:
  reg:
    required: true

  interrupts:
    required: true

  clocks:
    required: true

  pinctrl-0:
    required: true

  pinctrl-names:
    required: true
```

## dts/bindings/i2c/realtek,rtl87x2g-i2c.yaml
```yaml
# Copyright(c) 2020, Realtek Semiconductor Corporation.
# SPDX-License-Identifier: Apache-2.0

description: |
  RTL87X2G I2C.

compatible: "realtek,rtl87x2g-i2c"

include: [i2c-controller.yaml, reset-device.yaml, pinctrl-device.yaml]

properties:
  reg:
    required: true

  interrupts:
    required: true

  clocks:
    required: true

  pinctrl-0:
    required: true

  pinctrl-names:
    required: true
```

## dts/bindings/ieee802154/realtek,rtl87x2g-ieee802154.yaml
```yaml
description: Realtek rtl87x2g IEEE 802.15.4 node

compatible: "realtek,rtl87x2g-ieee802154"

include: base.yaml
```

## dts/bindings/kscan/realtek,rtl8752h-kscan.yaml
```yaml
# Copyright(c) 2024, Realtek Semiconductor Corporation.
# SPDX-License-Identifier: Apache-2.0

description: |
  RTL8752H KSCAN.

  The RTL8752H KSCAN should be used with an external kscan matrix.
  There is a total of 12 rows and 20 columns. You can assign any available pins
  to row or colunm by pinctrl.
  The rows and columns need to be indexed starting from 0.

  Example of devicetree configuration.

  &kscan {
        pinctrl-0 = <&kscan_default>;
        pinctrl-names = "default";
        row-size = <2>;
        col-size = <2>;
        debounce-time-ms = <10>;
        scan-time-ms = <10>;
        release-time-ms = <10>;
        scan-debounce-cnt = <1>;
        status = "okay";
    };

    &pinctrl {
        kscan_default: kscan_default {
            group1 {
              psels = <RTL8752H_PSEL(KEY_COL_0, P0_6, DIR_OUT, DRV_LOW, PULL_NONE)>,
              <RTL8752H_PSEL(KEY_COL_1, P0_7, DIR_OUT, DRV_LOW, PULL_NONE)>;
            };
            group2 {
              psels = <RTL8752H_PSEL(KEY_ROW_0, P2_4, DIR_IN, DRV_LOW, PULL_UP)>,
              <RTL8752H_PSEL(KEY_ROW_1, P2_5, DIR_IN, DRV_LOW, PULL_UP)>;
              bias-pull-strong;
            };
        };
    };

compatible: "realtek,rtl8752h-kscan"

include: [kscan.yaml, pinctrl-device.yaml]

properties:
  reg:
    required: true

  clocks:
    required: true

  interrupts:
    required: true

  pinctrl-0:
    required: true

  pinctrl-names:
    required: true

  max-row-size:
    type: int
    default: 12
    required: true
    description: Max row size of kscan array.

  max-col-size:
    type: int
    default: 20
    required: true
    description: Max column size of kscan array.

  row-size:
    type: int
    required: true
    description: Actual row size of external kscan matrix.

  col-size:
    type: int
    required: true
    description: Actual column size of external kscan matrix.

  debounce-time-us:
    type: int
    description: Debounce time for hardware debounce first time, range from 0 to 10240,
                 unit is us. The resolution is 20us.

  scan-time-us:
    type: int
    description: Scan interval time, range from 0 to 10240, unit is us.
                 The resolution is 20us.

  release-time-us:
    type: int
    description: All release detect time, range from 0 to 10240, unit is us.
                 The resolution is 20us.

  scan-debounce-cnt:
    type: int
    default: 1
    description: Counter for scan interval to realize software debounce,
      unit is times.
      The actual software-realized debounce time for each key change
      is scan-debounce-cnt * scan-time-ms.
```
