## dts/bindings/kscan/realtek,rtl87x2g-kscan.yaml
```yaml
# Copyright(c) 2020, Realtek Semiconductor Corporation.
# SPDX-License-Identifier: Apache-2.0

description: |
  RTL87X2G KSCAN.

  The RTL87X2G KSCAN should be used with an external kscan matrix.
  There is a total of 12 rows and 20 columns. You can assign any available pins to row or colunm by pinctrl.
  The rows and columns need to be indexed starting from 0.

  Example of devicetree configuration.

  &kscan {
        pinctrl-0 = <&kscan_default>;
        pinctrl-names = "default";
        row-size = <2>;
        col-size = <2>;
        debounce-time-ms = <10>;
        scan-time-ms = <10>;
        release-time-ms = <10>;
        scan-debounce-cnt = <1>;
        status = "okay";
    };

    &pinctrl {
        kscan_default: kscan_default {
            group1 {
              psels = <RTL87X2G_PSEL(KEY_COL_0, P0_6, DIR_OUT, DRV_LOW, PULL_NONE)>,
              <RTL87X2G_PSEL(KEY_COL_1, P0_7, DIR_OUT, DRV_LOW, PULL_NONE)>;
            };
            group2 {
              psels = <RTL87X2G_PSEL(KEY_ROW_0, P2_4, DIR_IN, DRV_LOW, PULL_UP)>,
              <RTL87X2G_PSEL(KEY_ROW_1, P2_5, DIR_IN, DRV_LOW, PULL_UP)>;
              bias-pull-strong;
            };
        };
    };

compatible: "realtek,rtl87x2g-kscan"

include: [kscan.yaml, pinctrl-device.yaml]

properties:
  reg:
    required: true

  clocks:
    required: true

  interrupts:
    required: true

  pinctrl-0:
    required: true

  pinctrl-1:
    required: false

  pinctrl-names:
    required: true

  max-row-size:
    type: int
    default: 12
    required: true
    description: Max row size of kscan array.

  max-col-size:
    type: int
    default: 20
    required: true
    description: Max column size of kscan array.

  row-size:
    type: int
    required: true
    description: Actual row size of external kscan matrix.

  col-size:
    type: int
    required: true
    description: Actual column size of external kscan matrix.

  debounce-time-us:
    type: int
    description: Debounce time for hardware debounce first time, range from 0 to 10240, unit is us.
                 The resolution is 20us.

  scan-time-us:
    type: int
    description: Scan interval time, range from 0 to 10240, unit is us.
                 The resolution is 20us.

  release-time-us:
    type: int
    description: All release detect time, range from 0 to 10240, unit is us.
                 The resolution is 20us.

  scan-debounce-cnt:
    type: int
    default: 1
    description: Counter for scan interval to realize software debounce, unit is times.
      The actual software-realized debounce time for each key change is scan-debounce-cnt * scan-time-ms.
```

## dts/bindings/pinctrl/realtek,rtl87x2g-pinctrl.yaml
```yaml
# Copyright(c) 2020, Realtek Semiconductor Corporation.
# SPDX-License-Identifier: Apache-2.0

description: |
    RTL87X2G pin controller.
    The rtl87x2g pin controller is a singleton node responsible for controlling
    pin function selection and pin properties. For example, you can use this
    node to route UART2 TX to pin P3_2 and enable the pull-up resistor on the
    pin.

    The node has the 'pinctrl' node label set in your SoC's devicetree,
    so you can modify it like this:

      &pinctrl {
              /* your modifications go here */
      };

    All device pin configurations should be placed in child nodes of the
    'pinctrl' node, as shown in this example:

      /* You can put this in places like a board-pinctrl.dtsi file in
       * your board directory, or a devicetree overlay in your application.
       */
      &pinctrl {
        /* configuration for uart2 device, default state */
        uart2_default: uart2_default {
          /* group 1 ('group1' name is arbitrary) */
          group1 {
            /* configure P3_2 as UART_TX and P3_3 as UART_RX */
            psels = <RTL87X2G_PSEL(UART2_TX, P3_2, DIR_OUT, DRV_HIGH, PULL_UP)>,
                    <RTL87X2G_PSEL(UART2_RX, P3_3, DIR_IN, DRV_HIGH, PULL_UP)>;
          };
        };
      };

    The 'uart2_default' child node encodes the pin configurations for a
    particular state of a device; in this case, the default (that is, active)
    state. You would specify the low-power configuration for the same device
    in a separate child node.

    As shown, pin configurations are organized in groups within each child node.
    Each group can specify a list of pin function selections in the 'psels'
    property. The RTL87X2G_PSEL macro is used to specify a pin function selection
    and pin configuration. You could choose pinmux specificed function to
    specificed pin. And you could configure driver direction, driver state and
    pull state for the specificed pad. Available pin functions and configurations
    can be found in the include\zephyr\dt-bindings\pinctrl\rtl87x2g-pinctrl.h
    header file.

    To link this pin configuration with a device, use a pinctrl-N property
    for some number N, like this example you could place in your board's DTS
    file:

       #include "rtl8762gn_evb-pinctrl.dtsi"

       &uart2 {
             pinctrl-0 = <&uart2_default>;
             pinctrl-names = "default";
       };

compatible: "realtek,rtl87x2g-pinctrl"

include: base.yaml

child-binding:
  description: |
    Rtl87x2g pin controller pin configuration state nodes.
  child-binding:
    description: |
      Rtl87x2g pin controller pin configuration group.

    properties:
      psels:
        required: true
        type: array
        description: |
          Pinmux function number and pad configurations.

      bias-pull-strong:
        type: boolean
        description: enable pull-strong resistor

      wakeup-high:
        type: boolean
        description: enable wakeup high function

      wakeup-low:
        type: boolean
        description: enable wakeup low function
```

## dts/bindings/ppt/realtek,rtl87x2g-ppt.yaml
```yaml
# Copyright(c) 2020, Realtek Semiconductor Corporation.
# SPDX-License-Identifier: Apache-2.0

description: |
  RTL87X2G PPT.

compatible: "realtek,rtl87x2g-ppt"

include: [base.yaml]

properties:
  enh-timers:
    type: phandles
    required: true
    description: |
      timer8 and timer9 will be used by ppt.
```

## dts/bindings/pwm/realtek,rtl8752h-pwm.yaml
```yaml
# Copyright(c) 2020, Realtek Semiconductor Corporation.
# SPDX-License-Identifier: Apache-2.0

description: RTL8752H PWM

compatible: "realtek,rtl8752h-pwm"

include: [base.yaml, pwm-controller.yaml, pinctrl-device.yaml]

properties:
  pinctrl-0:
    required: true

  pinctrl-names:
    required: true

  "#pwm-cells":
    const: 3

pwm-cells:
  - channel
  - period
  - flags
```

## dts/bindings/pwm/realtek,rtl87x2g-pwm.yaml
```yaml
# Copyright(c) 2020, Realtek Semiconductor Corporation.
# SPDX-License-Identifier: Apache-2.0

description: RTL87X2G PWM

compatible: "realtek,rtl87x2g-pwm"

include: [base.yaml, pwm-controller.yaml, pinctrl-device.yaml]

properties:
  pinctrl-0:
    required: true

  pinctrl-names:
    required: true

  clocks:
    required: false

  "#pwm-cells":
    const: 3

pwm-cells:
  - channel
  - period
  - flags
```

## dts/bindings/rng/realtek,rtl8752h-trng.yaml
```yaml
# Copyright(c) 2024, Realtek Semiconductor Corporation.
# SPDX-License-Identifier: Apache-2.0

description: RTL8752H TRNG

compatible: "realtek,rtl8752h-trng"

include: base.yaml

properties:
  reg:
    required: true
```

## dts/bindings/rng/realtek,rtl87x2g-trng.yaml
```yaml
# Copyright(c) 2020, Realtek Semiconductor Corporation.
# SPDX-License-Identifier: Apache-2.0

description: RTL87X2G TRNG

compatible: "realtek,rtl87x2g-trng"

include: base.yaml

properties:
  reg:
    required: true
```

## dts/bindings/sensor/realtek,rtl87x2g-aon_qdec.yaml
```yaml
# Copyright(c) 2020, Realtek Semiconductor Corporation.
# SPDX-License-Identifier: Apache-2.0

description: |
  RTL87X2G AON_QDEC.

compatible: "realtek,rtl87x2g-aon_qdec"

include: [sensor-device.yaml, pinctrl-device.yaml]

properties:
  reg:
    required: true

  interrupts:
    required: true

  pinctrl-0:
    required: true

  counts-per-revolution:
    type: int
    required: true
    default: 4
    description: |
      This is a number that is used to determine how many revolutions
      were done based on the current counter's value.
    enum:
      - 2
      - 4

  debounce-time-ms:
    type: int
    default: 4
    description: |
      Set the debounce time. The unit is ms.
```

## dts/bindings/serial/realtek,rtl8752h-uart.yaml
```yaml
# Copyright(c) 2020, Realtek Semiconductor Corporation.
# SPDX-License-Identifier: Apache-2.0

description: |
  RTL8752H UART.

compatible: "realtek,rtl8752h-uart"

include: [uart-controller.yaml, base.yaml, pinctrl-device.yaml]

bus: uart

properties:
  reg:
    required: true

  clocks:
    required: true

  interrupts:
    required: true

  pinctrl-0:
    required: true

  pinctrl-names:
    required: true

  flow-ctrl:
    type: boolean
    description: |
      Enable cts and rts or not.
```

## dts/bindings/spi/realtek,rtl8752h-spi.yaml
```yaml
# Copyright(c) 2024, Realtek Semiconductor Corporation.
# SPDX-License-Identifier: Apache-2.0

description: RTL8752H SPI

compatible: "realtek,rtl8752h-spi"

include: [spi-controller.yaml, reset-device.yaml, pinctrl-device.yaml]

properties:
  reg:
    required: true

  interrupts:
    required: true

  clocks:
    required: true

  pinctrl-0:
    required: true

  pinctrl-names:
    required: true
```

## dts/bindings/spi/realtek,rtl87x2g-spi.yaml
```yaml
# Copyright(c) 2020, Realtek Semiconductor Corporation.
# SPDX-License-Identifier: Apache-2.0

description: RTL87X2G SPI

compatible: "realtek,rtl87x2g-spi"

include: [spi-controller.yaml, reset-device.yaml, pinctrl-device.yaml]

properties:
  reg:
    required: true

  interrupts:
    required: true

  clocks:
    required: true

  pinctrl-0:
    required: true

  pinctrl-names:
    required: true
```

## dts/bindings/usb/realtek,rtl87x2g-udc.yaml
```yaml
# Copyright(c) 2024, Realtek Semiconductor Corporation.
# SPDX-License-Identifier: Apache-2.0

description: |
  RTL87X2G USB device controller.

compatible: "realtek,rtl87x2g-udc"

include: ["snps,dwc2.yaml", pinctrl-device.yaml]

properties:
  reg:
    required: true

  interrupts:
    required: true
```

## dts/bindings/usb/realtek,rtl87x2g-usb.yaml
```yaml
# Copyright(c) 2020, Realtek Semiconductor Corporation.
# SPDX-License-Identifier: Apache-2.0

description: |
  RTL87X2G USB device controller.

compatible: "realtek,rtl87x2g-usb"

include: usb-ep.yaml

properties:
  reg:
    required: true

  interrupts:
    required: true
```

## dts/bindings/watchdog/realtek,rtl87x2g-core-wdt.yaml
```yaml
description: RealTek core watchdog timer

compatible: "realtek,rtl87x2g-core-wdt"

include: base.yaml

properties:
  reg:
    required: true

  initial-timeout-ms:
    type: int
    default: 4000
    description: |
      Set timeout value in milliseconds.
```

## dts/bindings/watchdog/realtek,rtl87x2g-wdt.yaml
```yaml
description: RealTek aon watchdog timer

compatible: "realtek,rtl87x2g-wdt"

include: base.yaml

properties:
  reg:
    required: true

  initial-timeout-ms:
    type: int
    default: 4000
    description: |
      Set timeout value in milliseconds.
```

## modules/Kconfig.realtek_bee
```kconfig
# Copyright(c) 2024, Realtek Semiconductor Corporation.
# SPDX-License-Identifier: Apache-2.0

config ZEPHYR_HAL_REALTEK_BEE_MODULE
	bool

config USE_HAL_REALTEK_BEE_ADC
	bool
	help
	  Enable HAL REALTEK BEE ADC driver

config USE_HAL_REALTEK_BEE_TIM
	bool
	help
	  Enable HAL REALTEK BEE TIM driver

config USE_HAL_REALTEK_BEE_ENHTIM
	bool
	help
	  Enable HAL REALTEK BEE ENHTIM driver

config USE_HAL_REALTEK_BEE_RTC
	bool
	help
	  Enable HAL REALTEK BEE RTC driver

config USE_HAL_REALTEK_BEE_DMA
	bool
	help
	  Enable HAL REALTEK BEE DMA driver

config USE_HAL_REALTEK_BEE_GPIO
	bool
	help
	  Enable HAL REALTEK BEE GPIO driver

config USE_HAL_REALTEK_BEE_I2C
	bool
	help
	  Enable HAL REALTEK BEE I2C driver

config USE_HAL_REALTEK_BEE_KEYSCAN
	bool
	help
	  Enable HAL REALTEK BEE KEYSCAN driver

config USE_HAL_REALTEK_BEE_AON_QDEC
	bool
	help
	  Enable HAL REALTEK BEE AON QDEC driver

config USE_HAL_REALTEK_BEE_UART
	bool
	help
	  Enable HAL REALTEK BEE UART driver

config USE_HAL_REALTEK_BEE_SPI
	bool
	help
	  Enable HAL REALTEK BEE SPI driver

config USE_HAL_REALTEK_BEE_USB
	bool
	help
	  Enable HAL REALTEK BEE USB driver

config USE_HAL_REALTEK_BEE_AON_WDT
	bool
	help
	  Enable HAL REALTEK BEE AON WDT driver

config USE_HAL_REALTEK_BEE_CORE_WDT
	bool
	help
	  Enable HAL REALTEK BEE CORE WDT driver

config USE_HAL_REALTEK_BEE_RCC
	bool
	help
	  Enable HAL REALTEK BEE RCC driver

config USE_HAL_REALTEK_BEE_NVIC
	bool
	help
	  Enable HAL REALTEK BEE NVIC driver

config USE_HAL_REALTEK_BEE_PINMUX
	bool
	help
	  Enable HAL REALTEK BEE PINMUX driver

config USE_HAL_REALTEK_BEE_HCI
	bool
	help
	  Enable HAL REALTEK BEE HCI driver
```

## samples/bee_pm_device/boards/rtl87x2g_evb.conf
```kconfig
CONFIG_HEAP_MEM_POOL_SIZE=1024
CONFIG_SHELL=y
CONFIG_PM=y
CONFIG_PM_DEVICE=y
CONFIG_LOG=y
CONFIG_LOG_PRINTK=y
CONFIG_LOG_MODE_DEFERRED=y
CONFIG_SERIAL=y
CONFIG_UART_ASYNC_API=y
CONFIG_UART_BEE_KEEP_ACTIVE_AFTER_RX_WAKEUP=y
CONFIG_UART_BEE_KEEP_ACTIVE_TIMEOUT_MSEC=0

CONFIG_GPIO=y
CONFIG_GPIO_LOG_LEVEL_ERR=y
CONFIG_DMA=y
CONFIG_COUNTER=y
CONFIG_PWM=y
CONFIG_SPI=y
CONFIG_I2C=y
CONFIG_RTC=y
CONFIG_RTC_BEE=y
CONFIG_RTC_ALARM=y
CONFIG_RTC_UPDATE=y
CONFIG_SENSOR=y
CONFIG_ADC=y
CONFIG_ADC_ASYNC=y
CONFIG_INPUT=y
CONFIG_INPUT_EVENT_DUMP=y
CONFIG_INPUT_BEE_KSCAN=y
CONFIG_BEE_INPUT_KSCAN_AUTOSCAN_MODE=n

CONFIG_CAN=y
CONFIG_CAN_SHELL=y

CONFIG_SDMMC_STACK=y
CONFIG_SDHC_LOG_LEVEL_ERR=y

CONFIG_LOG_PROCESS_TRIGGER_THRESHOLD=1
```

## samples/drivers/i2s/i2s_rtl8752h/boards/rtl8752htv_evb.conf
```kconfig
# each pingpong buffer will malloc 2 BLOCK_SIZE buffer
CONFIG_HEAP_MEM_POOL_SIZE=2048
CONFIG_AUDIO=y
CONFIG_AUDIO_CODEC=y
CONFIG_I2S=y
CONFIG_BOOT_BANNER=n
CONFIG_I2S_RTL8752H_RX=y
CONFIG_I2S_RTL8752H_TX=y
```

## samples/ir/sample.yaml
```yaml
sample:
  description: IR sample, the simplest Zephyr
    application
  name: IR
common:
  tags: introduction
  integration_platforms:
    - native_posix
  harness: console
  harness_config:
    type: one_line
    regex:
      - "IR! (.*)"
tests:
  sample.basic.ir:
    tags: introduction
```
