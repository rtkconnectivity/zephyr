## prj.conf
```kconfig
CONFIG_ZTEST=y
CONFIG_THREAD_CUSTOM_DATA=y
CONFIG_POLL=y
CONFIG_SYS_HEAP_RUNTIME_STATS=y
CONFIG_ASSERT=y
```

## boards/rtl87x2g_evb.overlay
```dts
/*
 * Copyright(c) 2025, Realtek Semiconductor Corporation.
 *
 * SPDX-License-Identifier: Apache-2.0
 */

/delete-node/ &tcm1;
/delete-node/ &tcm_heap;
/ {
	tcm {
		#address-cells = <1>;
		#size-cells = <1>;
		tcm1: memory@119c00 {
			reg  = <0x00119c00 DT_SIZE_K(40)>;
			compatible = "zephyr,memory-region", "arm,itcm";
			zephyr,memory-region = "ITCM";
		};
		tcm_heap: memory@123c00 {
			compatible = "mmio-sram";
			reg  = <0x123c00 DT_SIZE_K(100)>;
		};
	};
};
```

## src/osif_mem.c
```c
/*
 * Copyright (c) 2025 Realtek Semiconductor Corp.
 *
 * SPDX-License-Identifier: Apache-2.0
 */
#include <zephyr/kernel.h>
#include <zephyr/ztest.h>
#include <stdlib.h>
#include <errno.h>
#include <time.h>
#include <stdint.h>
#include <os_mem.h>
#include <trace.h>
#include <mem_types.h>

#define TOO_BIG PTRDIFF_MAX

#define BUF_LEN 10

/* The access test allocates objects of this type and dereferences members. */
union aligntest {
	long long thelonglong;
	double thedouble;
	uintmax_t theuintmax_t;
	void (*thepfunc)(void);
	time_t thetime_t;
};

/* Make sure we can access some built-in types. */
static void do_the_access(volatile union aligntest *aptr)
{
	aptr->thelonglong = 2;
	aptr->thelonglong;

	if (IS_ENABLED(CONFIG_FPU)) {
		aptr->thedouble = 3.0;
		aptr->thedouble;
	}

	aptr->theuintmax_t = 4;
	aptr->theuintmax_t;

	aptr->thepfunc = test_main;
	aptr->thepfunc;

	aptr->thetime_t = 3;
	aptr->thetime_t;
}

#define PRINT_TYPE_INFO(_t) TC_PRINT("    %-14s  %4zu  %5zu\n", #_t, sizeof(_t), __alignof__(_t))

ZTEST(osif_mem, test_align_access)
{
	char *ptr[64] = {NULL};

	TC_PRINT("  Compiler type info for " CONFIG_ARCH " " CONFIG_BOARD "\n");
	TC_PRINT("    TYPE            SIZE  ALIGN\n");
	PRINT_TYPE_INFO(int);
	PRINT_TYPE_INFO(long);
	PRINT_TYPE_INFO(long long);
	PRINT_TYPE_INFO(double);
	PRINT_TYPE_INFO(size_t);
	PRINT_TYPE_INFO(void *);
	PRINT_TYPE_INFO(void (*)(void));
	PRINT_TYPE_INFO(time_t);

	/* Tries to use the os_mem_alloc( implementation when in different states. */
	for (size_t i = 0; i < ARRAY_SIZE(ptr); i++) {
		union aligntest *aptr = NULL;

		ptr[i] = os_mem_alloc(RAM_TYPE_DATA_ON, sizeof *(ptr[i]));
		aptr = os_mem_alloc(RAM_TYPE_DATA_ON, sizeof(*aptr));
		if (aptr) {
			do_the_access(aptr);
		}
		os_mem_free(aptr);
	}
	for (size_t i = 0; i < ARRAY_SIZE(ptr); i++) {
		os_mem_free(ptr[i]);
		ptr[i] = NULL;
	}

	for (size_t n = 0; n < ARRAY_SIZE(ptr); n++) {
		union aligntest *aptr = NULL;

		for (size_t i = 0; i < n; i++) {
			ptr[i] = os_mem_alloc(RAM_TYPE_DATA_ON, sizeof *(ptr[i]));
		}
		aptr = os_mem_alloc(RAM_TYPE_DATA_ON, sizeof(*aptr));
		if (aptr) {
			do_the_access(aptr);
		}
		os_mem_free(aptr);
		for (size_t i = 0; i < n; i++) {
			os_mem_free(ptr[i]);
			ptr[i] = NULL;
		}
	}

	for (size_t n = 0; n < ARRAY_SIZE(ptr); n++) {
		union aligntest *aptr = NULL;

		ptr[n] = os_mem_alloc(RAM_TYPE_DATA_ON, n);
		aptr = os_mem_alloc(RAM_TYPE_DATA_ON, sizeof(*aptr));
		if (aptr) {
			do_the_access(aptr);
		}
		os_mem_free(aptr);
		os_mem_free(ptr[n]);
		ptr[n] = NULL;
	}
}

/**
 * @brief Test dynamic memory allocation using os_mem_alloc.
 *
 * @see os_mem_alloc_intern_zephyr()
 */
ZTEST(osif_mem, test_os_mem_alloc)
{
	/* Initialize error number to avoid garbage value, in case of SUCCESS */
	int *iptr = NULL;

	/* Basic alloc and free testing. */
	iptr = os_mem_alloc(RAM_TYPE_DATA_ON, BUF_LEN * sizeof(int));
	zassert_not_null((iptr), "os_mem_alloc failed, type RAM_TYPE_DATA_ON, errno: %d", errno);
	memset(iptr, 'p', BUF_LEN * sizeof(int));
	os_mem_free(iptr);
	iptr = NULL;

	iptr = os_mem_alloc(RAM_TYPE_BUFFER_ON, BUF_LEN * sizeof(int));
	zassert_not_null((iptr), "os_mem_alloc failed, type RAM_TYPE_BUFFER_ON errno: %d", errno);
	memset(iptr, 'p', BUF_LEN * sizeof(int));
	os_mem_free(iptr);
	iptr = NULL;

	/* Alloc a memory that is too big */

	iptr = os_mem_alloc(RAM_TYPE_DATA_ON, 180 * 1024);
	zassert_is_null((iptr), "os_mem_alloc passed unexpectedly");

	uint32_t key = irq_lock();
	uint32_t heap_itcm_free_size = os_mem_peek(RAM_TYPE_DATA_ON);

	/* Test the heap allocate Strategy: first heap_itcm, then heap_dtcm and finally heap_sram.
	 */
	if (heap_itcm_free_size >
	    0) { /*in case the lowstack and platform has run out of heap_itcm.*/
		iptr = os_mem_alloc(RAM_TYPE_DATA_ON, heap_itcm_free_size);
		zassert_not_null(
			(iptr),
			"os_mem_alloc failed with maxiumn size, type RAM_TYPE_DATA_ON, errno: %d",
			errno);
		zassert_true((uint32_t)iptr >=
				     (DT_REG_ADDR(DT_NODELABEL(tcm_heap)) &&
				      (uint32_t)iptr <= (DT_REG_ADDR(DT_NODELABEL(tcm_heap)) +
							 DT_REG_SIZE(DT_NODELABEL(tcm_heap)))),
			     "Address out of expected heap_itcm region");
	}

	irq_unlock(key);

	os_mem_free(iptr);
	iptr = NULL;
}

/**
 * @brief Test dynamic memory allocation using os_mem_alloc.
 *
 * @see os_mem_alloc_intern_zephyr()
 */
ZTEST(osif_mem, test_os_mem_peek)
{
	size_t p_size;

	p_size = os_mem_peek(RAM_TYPE_DATA_ON);
}

/**
 * @brief Test dynamic memory free function using os_mem_free.
 *
 * @see os_mem_free()
 */
ZTEST(osif_mem, test_os_mem_free)
{
	/*
	 * In os_mem_free, if ptr is passed as NULL, no operation is performed
	 * Just make sure, no exception occurs and test pass
	 */
	os_mem_free(NULL);
	os_mem_aligned_free(NULL);
}

/**
 * @brief Test dynamic memory allocation function using os_mem_zalloc.
 *
 * @see os_mem_zalloc()
 */
ZTEST(osif_mem, test_os_mem_zalloc)
{
	/* Initialize error number to avoid garbage value, in case of SUCCESS */
	int *iptr = NULL;

	/* Basic alloc and free testing. */
	iptr = os_mem_zalloc(RAM_TYPE_DATA_ON, BUF_LEN * sizeof(int));
	zassert_not_null((iptr), "os_mem_zalloc failed, type RAM_TYPE_DATA_ON, errno: %d", errno);
	memset(iptr, 'p', BUF_LEN * sizeof(int));
	os_mem_free(iptr);
	iptr = NULL;

	iptr = os_mem_zalloc(RAM_TYPE_DATA_ON, BUF_LEN * sizeof(int));
	zassert_not_null((iptr), "os_mem_zalloc failed, type RAM_TYPE_DATA_ON, errno: %d", errno);
	zassert_true((*iptr == 0 && *(iptr + BUF_LEN - 1) == 0),
		     "os_mem_zalloc failed, the value in the alloced region is not zero! *iptr:%d, "
		     "*(iptr+BUF_LEN-1) %d",
		     *iptr, *(iptr + BUF_LEN - 1));
	os_mem_free(iptr);
	iptr = NULL;
}

#define MAX_LEN (10 * BUF_LEN)

/**
 *
 * @brief Test dynamic memory allocation up to maximum size
 * Negative test case
 *
 */
__no_optimization void _test_memalloc_max(void)
{
	char *ptr = NULL;

	ptr = os_mem_alloc(RAM_TYPE_DATA_ON, TOO_BIG);
	zassert_is_null(ptr, "malloc passed unexpectedly");
	os_mem_free(ptr);
	ptr = NULL;
}

ZTEST(osif_mem, test_memalloc_max)
{
	_test_memalloc_max();
}

ZTEST_SUITE(osif_mem, NULL, NULL, NULL, NULL, NULL);
```

## src/osif_msgq.c
```c
/*
 * Copyright (c) 2025 Realtek Semiconductor Corp.
 *
 * SPDX-License-Identifier: Apache-2.0
 */
#include <zephyr/ztest.h>
#include <zephyr/kernel.h>
#include <os_task.h>
#include <os_msg.h>
#include <os_sched.h>

struct sample_data {
	int data1;
	unsigned char data2;
	unsigned int data3;
};

#define MESSAGE1   512
#define MESSAGE2   123456
#define TIMEOUT_MS 500
#define Q_LEN      5
#define STACKSZ    1024

void *msgq_id;

void send_msg_thread(void *argument)
{
	int i;
	bool status;
	uint32_t msg_num;
	struct sample_data sample;
	struct sample_data data[Q_LEN] = {{0}};

	/* Wait for message_recv to complete initial checks */
	os_delay(TIMEOUT_MS);

	/* Prepare and send the 1st message (a simple integer data) */
	sample.data1 = MESSAGE1;
	status = os_msg_send(msgq_id, &sample, 0xFFFFFFFF);
	zassert_true(status == true, "os_msg_send failure for Message1");

	status = os_msg_queue_peek(msgq_id, &msg_num);
	zassert_true(status == true, "Something's wrong with os_msg_queue_peek!");

	/* The Queue should be empty at this point */
	zassert_equal(msg_num, 0, "The msg_num is not 0 unexpectedly!");

	/* Fill the queue with blocks of messages */
	for (i = 0; i < Q_LEN; i++) {
		data[i].data1 = i * 3;
		data[i].data2 = i * 3 + 1;
		data[i].data3 = i * 3 + 2;
		status = os_msg_send(msgq_id, data + i, 0xFFFFFFFF);
		zassert_true(status == true, "os_msg_send failure for message!");
	}

	status = os_msg_queue_peek(msgq_id, &msg_num);
	zassert_true(status == true, "Something's wrong with os_msg_queue_peek!");

	/* The Queue should be full at this point */
	zassert_equal(msg_num, Q_LEN, "The msg_num is not FULL unexpectedly!");

	/* Try putting message to a full queue immediately
	 * before it is emptied out and assert failure
	 */
	sample.data1 = MESSAGE2;
	status = os_msg_send(msgq_id, &sample, 0);
	zassert_true(status == false, "Something's wrong with os_msg_send. Sending msg to a full "
				      "queue unexpectedly succeeded!");

	/* Try putting message to a full queue within a duration
	 * less than TIMEOUT_TICKS, before the queue is emptied out
	 */
	sample.data1 = MESSAGE2;
	status = os_msg_send(msgq_id, &sample, TIMEOUT_MS / 2);
	zassert_true(status == false, "Something's wrong with os_msg_send. Sending msg to a full "
				      "queue unexpectedly succeeded!");

	/* Send another message after the queue is emptied */
	sample.data1 = MESSAGE2;
	status = os_msg_send(msgq_id, &sample, TIMEOUT_MS * 2);
	zassert_true(status == true, "os_msg_send failure for message!");
}

void message_recv(void)
{
	int i;
	bool status;
	struct sample_data recv_data;

	/* Try getting message immediately before the queue is populated */
	status = os_msg_recv(msgq_id, (void *)&recv_data, 0);
	zassert_true(status == false, "Something's wrong with os_msg_recv!");

	/* Try receiving message within a duration of TIMEOUT */
	status = os_msg_recv(msgq_id, (void *)&recv_data, TIMEOUT_MS);
	zassert_true(status == false, "Something's wrong with os_msg_recv!");

	/* Receive 1st message */
	status = os_msg_recv(msgq_id, (void *)&recv_data, 0xFFFFFFFF);
	zassert_true(status == true, "os_msg_recv failure");
	zassert_equal(recv_data.data1, MESSAGE1);

	/* Wait for queue to get filled */
	os_delay(TIMEOUT_MS);

	/* Empty the queue */
	for (i = 0; i < Q_LEN; i++) {
		status = os_msg_recv(msgq_id, (void *)&recv_data, 0xFFFFFFFF);
		zassert_true(status == true, "os_msg_recv failure");

		zassert_equal(recv_data.data1, i * 3);
		zassert_equal(recv_data.data2, i * 3 + 1);
		zassert_equal(recv_data.data3, i * 3 + 2);
	}

	/* Receive the next message */
	status = os_msg_recv(msgq_id, (void *)&recv_data, 0xFFFFFFFF);
	zassert_true(status == true, "os_msg_recv failure");
	zassert_equal(recv_data.data1, MESSAGE2);
}

ZTEST(osif_msgq, test_messageq)
{
	bool status;
	struct sample_data sample;
	void *tid;
	uint32_t task_param;
	uint32_t msg_num;

	status = os_msg_queue_create(&msgq_id, "Test Msg Q", Q_LEN, sizeof(struct sample_data));
	zassert_true(status != false, "Message Queue creation failed");

	status = os_task_create(&tid, "send_thread", send_msg_thread, &task_param, STACKSZ, 3);
	zassert_true(status != false, "Failed creating thread3");

	message_recv();

	/* Wait for the send_msg_thread to terminate before this thread
	 * terminates.
	 */
	os_delay(TIMEOUT_MS / 10);

	/* Make sure msgq is empty */
	status = os_msg_queue_peek(msgq_id, &msg_num);
	/* The Queue should be empty at this point */
	zassert_equal(msg_num, 0, "The msg_num is not 0 unexpectedly!");

	sample.data1 = MESSAGE1;
	/* no recv waiting， No task waiting，so return success immediately. */
	status = os_msg_send(
		msgq_id, &sample,
		0xFFFFFFFF);
	zassert_true(status == true, "os_msg_send failure for Message1");

	status = os_msg_queue_peek(msgq_id, &msg_num);
	/* The Queue should be empty at this point */
	zassert_equal(msg_num, 1, "The msg_num is not 1 unexpectedly!");

	status = os_msg_queue_delete(msgq_id);
	zassert_true(status == true, "os_msg_queue_delete failure");

	status = os_task_delete(tid);
	zassert_true(status == true, "Error deleting TestMsgQ task");
}
ZTEST_SUITE(osif_msgq, NULL, NULL, NULL, NULL, NULL);
```

## src/osif_semaphore.c
```c
/*
 * Copyright (c) 2025 Realtek Semiconductor Corp.
 *
 * SPDX-License-Identifier: Apache-2.0
 */
#include <zephyr/ztest.h>
#include <zephyr/kernel.h>
#include <os_task.h>
#include <os_sync.h>
#include <os_sched.h>

#define WAIT_MS    50
#define TIMEOUT_MS (100 + WAIT_MS)
#define STACKSZ    1024

void thread_sema(void *arg)
{
	bool status;

	/* Try taking semaphore immediately when it is not available */
	status = os_sem_take((struct k_sem *)arg, 0);
	zassert_true(status == false, "Semaphore acquired unexpectedly!");

	/* Try taking semaphore after a TIMEOUT, but before release */
	status = os_sem_take((struct k_sem *)arg, WAIT_MS);
	zassert_true(status == false, "Semaphore acquired unexpectedly!");

	/* This delay ensures that the semaphore gets released by the other
	 * thread in the meantime
	 */
	os_delay(TIMEOUT_MS);

	/* Now that the semaphore is free, it should be possible to acquire
	 * and release it.
	 */
	status = os_sem_take((struct k_sem *)arg, 0);
	zassert_true(status == true, "Semaphore could not be acquired");

	zassert_true(os_sem_give((struct k_sem *)arg) == true, "Semaphore release failure");

	/* Try releasing when no semaphore is obtained */
	zassert_true(os_sem_give((struct k_sem *)arg) == false, "Semaphore released unexpectedly!");
}

ZTEST(osif_semaphore, test_semaphore)
{
	void *semaphore_id;
	bool status;
	void *tid;
	void *dummy_sem_id = NULL;

	status = os_sem_create(&semaphore_id, "mySemaphore", 1, 1);
	zassert_true(status != false, "semaphore creation failed");

	status = os_task_create(&tid, "Sema_check", thread_sema, semaphore_id, STACKSZ, 3);
	zassert_true(status != false, "Failed creating thread3");

	/* Acquire invalid semaphore */
	zassert_equal(os_sem_take(dummy_sem_id, 0xFFFFFFFF), false,
		      "Semaphore wait worked unexpectedly");

	status = os_sem_take(semaphore_id, 0xFFFFFFFF);
	zassert_true(status == true, "Semaphore wait failure");

	/* wait for spawn thread to take action */
	os_delay(TIMEOUT_MS);

	/* Release invalid semaphore */
	zassert_equal(os_sem_give(dummy_sem_id), false, "Semaphore release worked unexpectedly");

	/* Release the semaphore to be used by the other thread */
	status = os_sem_give(semaphore_id);
	zassert_true(status == true, "Semaphore release failure");

	os_delay(TIMEOUT_MS);

	/* Delete invalid semaphore */
	zassert_equal(os_sem_delete(dummy_sem_id), false, "Semaphore delete worked unexpectedly");

	status = os_sem_delete(semaphore_id);
	zassert_true(status == true, "semaphore delete failure");

	status = os_task_delete(tid);
	zassert_true(status == true, "Error deleting Sema_check task");
}
ZTEST_SUITE(osif_semaphore, NULL, NULL, NULL, NULL, NULL);
```

## src/osif_task_apis.c
```c
/*
 * Copyright (c) 2025 Realtek Semiconductor Corp.
 *
 * SPDX-License-Identifier: Apache-2.0
 */
#include <zephyr/ztest.h>
#include <zephyr/kernel.h>
#include <os_task.h>
#include <os_sched.h>

#define STACKSZ 2048

/* This is used to check the thread yield functionality between 2 threads */
static int thread_yield_check;

/* This is used to indicate the completion of processing for thread3 */
static int thread3_state;

void *id4;

void thread1(void *argument)
{
	bool status;
	void *id;

	status = os_task_handle_get(&id);

	zassert_true(id != NULL, "os_task_handle_get failed");

	/* This thread starts off at a high priority (same as thread2) */
	thread_yield_check++;
	zassert_equal(thread_yield_check, 1);

	/* Yield to thread2 which is of same priority */
	status = os_task_yield();
	zassert_true(status == true, "Error doing thread yield");

	/* thread_yield_check should now be 2 as it was incremented
	 * in thread2.
	 */
	zassert_equal(thread_yield_check, 2);
}

void thread2(void *argument)
{
	/* By now thread1 would have set thread_yield_check to 1 and would
	 * have yielded the CPU. Incrementing it over here would essentially
	 * confirm that the yield was indeed executed.
	 */
	thread_yield_check++;

	/* Yield back to thread1 which is of same priority */
	os_task_yield();
}

void thread3(void *argument)
{
	bool status;
	uint16_t rv;
	void *id;
	uint16_t prio;

	status = os_task_handle_get(&id);
	status = os_task_priority_get(id, &prio);

	/* Lower the priority of the current thread */
	os_task_priority_set(id, 2);
	status = os_task_priority_get(id, &rv);
	zassert_equal(rv, 2, "Expected priority to be changed to %d, not %d", 2, rv);

	/* Increase the priority of the current thread */
	os_task_priority_set(id, 4);
	status = os_task_priority_get(id, &rv);
	zassert_equal(rv, 4, "Expected priority to be changed to %d, not %d", 4, rv);

	/* Restore the priority of the current thread */
	os_task_priority_set(id, prio);
	status = os_task_priority_get(id, &rv);
	zassert_equal(rv, prio, "Expected priority to be changed to %d, not %d", prio, rv);

	/* Try to set unsupported priority and assert failure */
	status = os_task_priority_set(id, 7);
	zassert_true(status == false, "Something's wrong with os_task_priority_set!");

	/* Indication that thread3 is done with its processing */
	thread3_state = 1;

	/* Keep looping till it gets killed */
	do {
		os_delay(100);
	} while (1);
}

void thread_delete_self(void *argument)
{
	bool status;

	id4 = NULL;
	status = os_task_delete(NULL);

	zassert_true(false, "Deleting self (NULL) would not return here!");
}

ZTEST(osif_task_apis, test_thread_prio)
{
	void *id3 = NULL;
	uint32_t task_param;
	bool status;

	status = os_task_create(&id3, "task3", thread3, &task_param, STACKSZ, 6);
	zassert_true(status != false, "Failed creating thread3");

	/* Keep delaying 10 milliseconds to ensure thread3 is done with
	 * its execution. It loops at the end and is terminated here.
	 */
	do {
		os_delay(10);
	} while (thread3_state == 0);

	status = os_task_delete(id3);
	zassert_true(status == true, "Error deleting thread3");

	/* Try to set priority to inactive thread and assert failure */
	status = os_task_priority_set(id3, 3);
	zassert_true(status == true, "Something's wrong with os_task_priority_set!");

	thread3_state = 0;
}

ZTEST(osif_task_apis, test_thread_apis)
{
	void *id1 = NULL;
	void *id2 = NULL;
	uint32_t task_param;
	bool status;

	status = os_task_create(&id1, "task1", thread1, &task_param, STACKSZ, 6);
	zassert_true(status != false, "Failed creating thread1");

	status = os_task_create(&id2, "task2", thread2, &task_param, STACKSZ, 6);
	zassert_true(status != false, "Failed creating thread2");

	do {
		os_delay(100);
	} while (thread_yield_check != 2);
}

ZTEST(osif_task_apis, test_delete_self_with_null)
{
	uint32_t task_param;
	bool status;

	status = os_task_create(&id4, "delete_self", thread_delete_self, &task_param, STACKSZ, 5);
	zassert_true(status == true, "Failed to create self-delete thread");

	os_delay(100);

	zassert_true(id4 == NULL, "Failed to delete thread!");
}

ZTEST_SUITE(osif_task_apis, NULL, NULL, NULL, NULL, NULL);
```

## src/osif_timer.c
```c
/*
 * Copyright (c) 2025 Realtek Semiconductor Corp.
 *
 * SPDX-License-Identifier: Apache-2.0
 */
#include <zephyr/ztest.h>
#include <os_timer.h>
#include <os_sched.h>

#define ONESHOT_TIME_MS 200
#define PERIOD_MS       100
#define NUM_PERIODS     5

#define TIMER_ID1 1
#define TIMER_ID2 2

uint32_t num_oneshots_executed;
uint32_t num_periods_executed;

void Timer1_Callback(void *arg)
{
	uint32_t timer_id;

	os_timer_id_get(&arg, &timer_id);
	zassert_equal(timer_id, TIMER_ID1, "Error getting Timer ID!");

	num_oneshots_executed++;
	TC_PRINT("oneshot_callback (Timer %d) = %d\n", timer_id, num_oneshots_executed);
}

void Timer2_Callback(void *arg)
{
	uint32_t timer_id;

	os_timer_id_get(&arg, &timer_id);
	zassert_equal(timer_id, TIMER_ID2, "Error getting Timer ID!");

	num_periods_executed++;
	TC_PRINT("periodic_callback (Timer %d) = %d\n", timer_id, num_periods_executed);
}

ZTEST(osif_timer, test_timer)
{
	void *timer1 = NULL;
	void *timer2 = NULL;
	bool status;
	uint32_t state;

	/* Create one-shot timer */
	status = os_timer_create(&timer1, "timer1", TIMER_ID1, ONESHOT_TIME_MS, false,
				 Timer1_Callback);
	zassert_true(status != false, "error creating one-shot timer");

	status = os_timer_is_timer_active(&timer1);
	zassert_true(status == false, "timer1 should be inactive!");

	/* Stop the timer before start */
	status = os_timer_stop(&timer1);
	zassert_true(status == false, "error while stopping non-active timer");

	status = os_timer_start(&timer1);
	zassert_true(status == true, "error starting one-shot timer");

	os_timer_state_get(&timer1, &state);
	zassert_equal(state, 1, "Error: Timer not running");

	status = os_timer_is_timer_active(&timer1);
	zassert_true(status == true, "timer1 should be active!");

	/* Timer should fire only once if setup in one shot
	 * mode. Wait for 3 times the one-shot time to see
	 * if it fires more than once.
	 */
	os_delay(ONESHOT_TIME_MS * 3U + 10);
	zassert_true(num_oneshots_executed == 1U,
		     "error setting up one-shot timer (using os_timer_start)");

	status = os_timer_stop(&timer1);
	zassert_true(status == false, "one-shot timer has expired, so cannot stop it!");

	status = os_timer_restart(&timer1, ONESHOT_TIME_MS * 2);
	zassert_true(status == true, "error restarting one-shot timer");

	os_delay(ONESHOT_TIME_MS * 6U + 15);
	zassert_true(num_oneshots_executed == 2U,
		     "error setting up one-shot timer (using os_timer_restart)");

	status = os_timer_delete(&timer1);
	zassert_true(status == true, "error deleting one-shot timer");

	/* Create periodic timer */
	status = os_timer_create(&timer2, "timer2", TIMER_ID2, PERIOD_MS, true, Timer2_Callback);
	zassert_true(status != false, "error creating periodic timer");

	os_timer_state_get(&timer2, &state);
	zassert_equal(state, 0, "Error: Timer is running");

	status = os_timer_start(&timer2);
	zassert_true(status == true, "error starting periodic timer");

	/* Timer should fire periodically if setup in periodic
	 * mode. Wait for NUM_PERIODS periods to see if it is
	 * fired NUM_PERIODS times.
	 */
	os_delay(PERIOD_MS * NUM_PERIODS + 10);

	zassert_true(num_periods_executed == NUM_PERIODS,
		     "error setting up periodic timer (using os_timer_start)");

	status = os_timer_restart(&timer2, PERIOD_MS * 2);
	zassert_true(status == true, "error starting periodic timer");

	os_delay(PERIOD_MS * NUM_PERIODS * 2 + 10);
	zassert_true(num_periods_executed == NUM_PERIODS * 2,
		     "error setting up periodic timer (using os_timer_restart)");

	/* Delete the timer before stop */
	status = os_timer_delete(&timer2);
	zassert_true(status == true, "error deleting periodic timer");
}
ZTEST_SUITE(osif_timer, NULL, NULL, NULL, NULL, NULL);
```
