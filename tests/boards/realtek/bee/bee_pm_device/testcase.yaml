## tests/boards/realtek/bee/bee_pm_device/testcase.yaml
```yaml
# Copyright (c) 2026 Realtek Semiconductor Corp.
# SPDX-License-Identifier: Apache-2.0

tests:
  boards.realtek.bee_pm_device:
    tags: bee_pm_device
    build_only: true
    platform_allow:
      - rtl87x2j_evb/rtl8762jth
```

## tests/boards/realtek/bee_osif/testcase.yaml
```yaml
tests:
  boards.realtek.bee_osif:
    tags: realtek_osif
    platform_allow:
      - rtl87x2g_evb_a
```

## tests/boards/realtek/bee_pm/testcase.yaml
```yaml
# Copyright (c) 2026 Realtek Semiconductor Corp.
# SPDX-License-Identifier: Apache-2.0

tests:
  boards.realtek.bee_pm:
    tags: bee_pm
    platform_allow:
      - rtl87x2j_evb/rtl8762jth
```

## tests/boards/realtek/pm/testcase.yaml
```yaml
# Copyright (c) 2026 Realtek Semiconductor Corp.
# SPDX-License-Identifier: Apache-2.0

common:
  tags: pm
  platform_allow:
    - rtl87x2j_evb/rtl8762jth
```

## tests/boards/rtl8752h_evb/pm/btmac_wakeup/testcase.yaml
```yaml
tests:
  boards.rtl8752h.pm.btmac_wakeup:
    platform_allow:
      - rtl8752h_evb/rtl8752htv
      - rtl8752h_evb/rtl8752hkf
    tags:
      - pm
      - bluetooth
```

## tests/boards/rtl8752h_evb/pm/pad_wakeup_dlps/testcase.yaml
```yaml
tests:
  boards.rtl8752h.pm.pad_wakeup_dlps:
    platform_allow:
      - rtl8752h_evb/rtl8752htv
      - rtl8752h_evb/rtl8752hkf
    tags:
      - pm
```

## tests/boards/rtl8752h_evb/pm/timeout_wakeup/testcase.yaml
```yaml
tests:
  boards.rtl8752h.pm.timeout_wakeup:
    platform_allow:
      - rtl8752h_evb/rtl8752htv
      - rtl8752h_evb/rtl8752hkf
    tags:
      - pm
```

## tests/boards/rtl87x2g_evb/pm/btmac_wakeup/testcase.yaml
```yaml
tests:
  boards.rtl87x2g.pm.btmac_wakeup:
    platform_allow:
      - rtl87x2g_evb
    tags:
      - pm
      - bluetooth
```

## tests/boards/rtl87x2g_evb/pm/pad_wakeup_dlps/testcase.yaml
```yaml
tests:
  boards.rtl87x2g.pm.pad_wakeup_dlps:
    platform_allow:
      - rtl87x2g_evb
    tags:
      - pm
```

## tests/boards/rtl87x2g_evb/pm/pad_wakeup_powerdown/testcase.yaml
```yaml
tests:
  boards.rtl87x2g.pm.pad_wakeup_powerdown:
    platform_allow:
      - rtl87x2g_evb
    tags:
      - pm
```

## tests/boards/rtl87x2g_evb/pm/timeout_wakeup/testcase.yaml
```yaml
tests:
  boards.rtl87x2g.pm.timeout_wakeup:
    platform_allow:
      - rtl87x2g_evb
    tags:
      - pm
```

## tests/drivers/disk/disk_access_bee/testcase.yaml
```yaml
common:
  harness: ztest
  tags: disk
  depends_on: sdhc
tests:
  drivers.disk.rtl87x2g.stress:
    build_only: true
    extra_args:
      - DTC_OVERLAY_FILE=boards/rtl87x2g_evb_a_rtl8762gku.overlay
    extra_configs:
      - CONFIG_DISK_ACCESS_TEST_ERASE=y
      - CONFIG_DISK_ACCESS_TEST_POWER_CYCLE=y
      - CONFIG_DISK_ACCESS_TEST_FS_FORMAT=y
      - CONFIG_DISK_ACCESS_STRESS=y
    platform_allow:
      - rtl87x2g_evb_a/rtl8762gku
```

## tests/drivers/flash/common/boards/rtl8752h_evb.conf
```kconfig
# Copyright(c) 2025, Realtek Semiconductor Corporation.
# SPDX-License-Identifier: Apache-2.0

CONFIG_MAIN_STACK_SIZE=4096
```

## tests/drivers/rtc/rtc_api/boards/rtl8762gn_evb.conf
```kconfig
# Copyright(c) 2025, Realtek Semiconductor Corporation.
# SPDX-License-Identifier: Apache-2.0

CONFIG_RTC_BEE=y
CONFIG_RTC_ALARM=y
CONFIG_RTC_UPDATE=y
```

## tests/drivers/rtc/rtc_api/testcase.yaml
```yaml
# Copyright (c) 2022 Bjarki Arge Andreasen
# SPDX-License-Identifier: Apache-2.0

tests:
  drivers.rtc.rtc_api:
    tags:
      - drivers
      - rtc
      - api
    filter: dt_alias_exists("rtc")
    depends_on: rtc
    timeout: 100
    platform_exclude:
      - qemu_x86_64
  drivers.rtc.rtc_api.rtl87x2g:
    platform_allow: rtl87x2g_evb
    extra_args: "DTC_OVERLAY_FILE=boards/rtl87x2g_evb.overlay"
    timeout: 90
  drivers.rtc.rtc_api.rtl8752h:
    platform_allow: rtl8752htv_evb
    extra_args: "DTC_OVERLAY_FILE=boards/rtl8752htv_evb.overlay"
    timeout: 90
```

## tests/drivers/spi/spi_controller_peripheral/boards/rtl8752htv_evb.conf
```kconfig
CONFIG_TESTED_SPI_MODE=1
# dma is optional
# CONFIG_SPI_BEE_DMA=y
# CONFIG_HEAP_MEM_POOL_SIZE=256
```

## tests/drivers/spi/spi_loopback/boards/rtl8752h_evb_rtl8752htv.conf
```kconfig
CONFIG_GPIO=y
CONFIG_SPI_ASYNC=y
CONFIG_ZTEST_STACK_SIZE=2048
# dma is optional
# CONFIG_SPI_BEE_DMA=y
# CONFIG_HEAP_MEM_POOL_SIZE=256
```

## tests/drivers/spi/spi_loopback/boards/rtl8762gn_evb.conf
```kconfig
CONFIG_GPIO=y
CONFIG_SPI_ASYNC=y
# dma is optional
CONFIG_SPI_RTL87X2G_DMA=y
CONFIG_HEAP_MEM_POOL_SIZE=1024
```

## tests/drivers/spi/spi_loopback/boards/rtl87x2g_evb.conf
```kconfig
CONFIG_GPIO=y
CONFIG_SPI_ASYNC=y
# dma is optional
# CONFIG_SPI_BEE_DMA=y
# CONFIG_HEAP_MEM_POOL_SIZE=256
```

## tests/kernel/pipe/pipe/testcase.yaml
```yaml
tests:
  kernel.pipe:
    tags:
      - kernel
      - userspace
    ignore_faults: true
    extra_configs:
      - CONFIG_TEST_EXTRA_STACK_SIZE=64
```
