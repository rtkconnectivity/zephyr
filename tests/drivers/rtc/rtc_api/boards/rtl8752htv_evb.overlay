/*
 * Copyright(c) 2024, Realtek Semiconductor Corporation.
 *
 * SPDX-License-Identifier: Apache-2.0
 */

 / {
	aliases {
		rtc = &rtc;
	};
};

&rtc {
    status = "okay";
    prescaler = <3200>;
};
