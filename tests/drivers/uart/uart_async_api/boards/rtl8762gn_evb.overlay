/*
 * Copyright(c) 2020, Realtek Semiconductor Corporation.
 *
 * SPDX-License-Identifier: Apache-2.0
 */

&uart2 {
    dmas = <&dma0 2 5 0xa>, <&dma0 3 4 0x10021>;
    dma-names = "rx", "tx";
};

&dma0 {
    status = "okay";
};