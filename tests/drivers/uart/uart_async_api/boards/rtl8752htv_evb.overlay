/*
 * Copyright(c) 2025, Realtek Semiconductor Corporation.
 *
 * SPDX-License-Identifier: Apache-2.0
 */

&uart2 {
	dmas = <&dma0 1 19 0xa>, <&dma0 2 18 0x10021>;
	dma-names = "rx", "tx";
};

&dma0 {
	status = "okay";
};
