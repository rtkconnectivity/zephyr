## modules/hal_realtek/bee/Kconfig.bee
```kconfig
# Copyright(c) 2026, Realtek Semiconductor Corporation.
# SPDX-License-Identifier: Apache-2.0

config ZEPHYR_HAL_REALTEK_BEE_MODULE
	bool

config HAL_REALTEK_BEE_ADC
	bool "Realtek Bee ADC HAL"

config HAL_REALTEK_BEE_BT
	bool "Realtek Bee BT HAL"

config HAL_REALTEK_BEE_CAN
	bool "Realtek Bee CAN HAL"

config HAL_REALTEK_BEE_CODEC
	bool "Realtek Bee CODEC HAL"

config HAL_REALTEK_BEE_DMA
	bool "Realtek Bee DMA HAL"

config HAL_REALTEK_BEE_GPIO
	bool "Realtek Bee GPIO HAL"

config HAL_REALTEK_BEE_GRTC
	bool "Realtek Bee GRTC HAL"

config HAL_REALTEK_BEE_I2C
	bool "Realtek Bee I2C HAL"

config HAL_REALTEK_BEE_I2S
	bool "Realtek Bee I2S HAL"

config HAL_REALTEK_BEE_IR
	bool "Realtek Bee IR HAL"

config HAL_REALTEK_BEE_KEYSCAN
	bool "Realtek Bee KeyScan HAL"

config HAL_REALTEK_BEE_NVIC
	bool "Realtek Bee NVIC HAL"

config HAL_REALTEK_BEE_PINMUX
	bool "Realtek Bee Pinmux HAL"

config HAL_REALTEK_BEE_PWM
	bool "Realtek Bee PWM HAL"

config HAL_REALTEK_BEE_AON_QDEC
	bool "Realtek Bee AON QDEC HAL"

config HAL_REALTEK_BEE_QDEC
	bool "Realtek Bee QDEC HAL"

config HAL_REALTEK_BEE_LPQDEC
	bool "Realtek Bee Low-Power QDEC HAL"

config HAL_REALTEK_BEE_RCC
	bool "Realtek Bee RCC HAL"

config HAL_REALTEK_BEE_RTC
	bool "Realtek Bee RTC HAL"

config HAL_REALTEK_BEE_SDHC
	bool "Realtek Bee SDHC HAL"

config HAL_REALTEK_BEE_SPI
	bool "Realtek Bee SPI HAL"

config HAL_REALTEK_BEE_TIM
	bool "Realtek Bee Timer HAL"

config HAL_REALTEK_BEE_ENHTIM
	bool "Realtek Bee Enhanced Timer HAL"

config HAL_REALTEK_BEE_UART
	bool "Realtek Bee UART HAL"

config HAL_REALTEK_BEE_USB
	bool "Realtek Bee USB HAL"

config HAL_REALTEK_BEE_AON_WDT
	bool "Realtek Bee AON Watchdog HAL"

config HAL_REALTEK_BEE_CORE_WDT
	bool "Realtek Bee Core Watchdog HAL"

menuconfig USE_REALTEK_BEE_OS_INTERFACE
	bool "Realtek Bee OS Interface (OSIF) Layer"
	select POLL
	help
	  Enable the Realtek Bee OS Interface (OSIF) abstraction layer.
	  This layer provides a unified API wrapper to ensure portability
	  across different underlying operating systems for Realtek Bee
	  family SoCs.

if USE_REALTEK_BEE_OS_INTERFACE

config REALTEK_BEE_OSIF_TIMER_MAX_COUNT
	int "Maximum number of timers"
	default 64
	range 0 255
	help
	  Set the maximum number of timer objects that can be allocated
	  simultaneously in the OSIF layer.

config REALTEK_BEE_OSIF_TASK_MAX_COUNT
	int "Maximum number of tasks"
	default 3
	range 0 255
	help
	  Set the maximum number of task (thread) objects supported by OSIF.

config REALTEK_BEE_OSIF_MSGQ_MAX_COUNT
	int "Maximum number of message queues"
	default 3
	range 0 255
	help
	  Set the maximum number of message queue objects supported by OSIF.

config REALTEK_BEE_OSIF_SEM_MAX_COUNT
	int "Maximum number of semaphores"
	default 3
	range 0 255
	help
	  Set the maximum number of semaphore objects supported by OSIF.

config REALTEK_BEE_OSIF_MUTEX_MAX_COUNT
	int "Maximum number of mutexes"
	default 3
	range 0 255
	help
	  Set the maximum number of mutex objects supported by OSIF.

endif # USE_REALTEK_BEE_OS_INTERFACE
```

## samples/bee_pm_device/dts/bindings/bee-pm-device-gpio.yaml
```yaml
description: |
    This binding provides resources required to build and run the
    bee_pm_device.

compatible: "bee-pm-device-gpio"

properties:
  out-gpios:
    type: phandle-array
    required: true
    description: |
      Identity of a GPIO that will be configured as an output.  This
      must be on the same device as in-gpios, and physically
      connected to in-gpios.

  in-gpios:
    type: phandle-array
    required: true
    description: |
      Identity of a GPIO that will be configured as an input.  This
      must be on the same device as out-gpios,and physically
      connected to out-gpios.
```

## samples/bee_pm_device/dts/bindings/bee-pm-device-spi.yaml
```yaml
description: |
    This binding provides resources required to build and run the
    bee_pm_device.

compatible: "bee-pm-device-spi"

include: [spi-device.yaml]
```

## samples/bee_pm_device/sample.yaml
```yaml
sample:
  description: Bee pm device sample
  name: bee pm device
common:
  tags: introduction
  harness: console
```

## samples/drivers/i2s/i2s_rtl8752h/sample.yaml
```yaml
sample:
  description: i2s sample for rtl8752h
  name: i2s
common:
  tags: introduction
  integration_platforms:
    - native_posix
  harness: console
  harness_config:
    type: one_line
    regex:
      - "i2s! (.*)"
tests:
  sample.basic.i2s:
    tags: introduction
```

## samples/subsys/usb/hid-mouse/boards/rtl87x2g_evb.conf
```kconfig
CONFIG_INPUT_BEE_KSCAN=y
CONFIG_KSCAN=y
CONFIG_KSCAN_INPUT=y
CONFIG_UDC_BUF_POOL_SIZE=32768
CONFIG_UDC_DWC2_DMA=y
```

## samples/subsys/usb/mass/boards/rtl87x2g_evb.conf
```kconfig
CONFIG_SDMMC_STACK=y

CONFIG_MAIN_STACK_SIZE=2048
CONFIG_COMMON_LIBC_MALLOC_ARENA_SIZE=8192

CONFIG_DISK_ACCESS=y
CONFIG_DISK_DRIVERS=y
CONFIG_DISK_DRIVER_SDMMC=y

CONFIG_FILE_SYSTEM=y
CONFIG_FAT_FILESYSTEM_ELM=y

CONFIG_APP_MSC_STORAGE_SDCARD=y

CONFIG_HEAP_MEM_POOL_SIZE=512

CONFIG_UDC_DWC2_DMA=y
```

## soc/realtek/bee/Kconfig
```kconfig
# Copyright (c) 2026, Realtek Semiconductor Corporation
# SPDX-License-Identifier: Apache-2.0

config SOC_FAMILY_REALTEK_BEE
	select BUILD_OUTPUT_HEX
	select HAS_SEGGER_RTT if ZEPHYR_SEGGER_MODULE

if SOC_FAMILY_REALTEK_BEE

rsource "*/Kconfig"

config SOC_FAMILY_REALTEK_BEE_IMAGE_HEADER
	bool
	default y
	help
	  This config will prepend bee_image_header on the zephyr binary.


config CRYPTO_BEE_PSA_ACCELERATOR
	bool "Accelerate PSA cryptography using Realtek Bee hardware"
	depends on MBEDTLS
	default y
	select PSA_WANT_KEY_TYPE_AES
	select PSA_WANT_ALG_ECB_NO_PADDING
	select PSA_WANT_ALG_CBC_NO_PADDING
	select PSA_WANT_ALG_CBC_PKCS7
	select PSA_WANT_ALG_CFB
	select PSA_WANT_ALG_OFB
	select PSA_WANT_ALG_CTR
	select PSA_WANT_ALG_SHA_256
	select PSA_WANT_ALG_ECDH if SOC_SERIES_RTL87X2G
	select PSA_WANT_KEY_TYPE_ECC_KEY_PAIR_BASIC if SOC_SERIES_RTL87X2G
	help
	  Route PSA AES and SHA-256 operations to the Realtek Bee hardware engine.
	  This also accelerates composite PSA algorithms such as CCM and
	  HMAC-SHA-256.

endif # SOC_FAMILY_REALTEK_BEE
```

## soc/realtek/bee/rtl8752h/Kconfig
```kconfig
# Copyright (c) 2024 Realtek Semiconductor Corp.
# SPDX-License-Identifier: Apache-2.0

config SOC_SERIES_RTL8752H
	select ARM
	select CPU_CORTEX_M0PLUS
	select CPU_CORTEX_M_HAS_VTOR
	select CPU_CORTEX_M_HAS_SYSTICK
	select CPU_HAS_ARM_MPU
	select DYNAMIC_INTERRUPTS
	select THREAD_STACK_INFO
	select HAS_PM
	help
	  Enable support for RTL8725H MCU series
```

## soc/realtek/bee/rtl8752h/Kconfig.defconfig
```kconfig
# Copyright (c) 2024 Realtek Semiconductor Corp.
# SPDX-License-Identifier: Apache-2.0
if SOC_SERIES_RTL8752H

# specifies the frequency of the hardware timer used for the system clock (in Hz)
config SYS_CLOCK_HW_CYCLES_PER_SEC
	int
	default 32000

config NUM_IRQS
	int
	default 32

config CORTEX_M_SYSTICK
	default y

config SYS_CLOCK_TICKS_PER_SEC
	int
	default 100
	#1s = 100 ticks

config RUNTIME_NMI
	default y

config PM_DEVICE
	default y
	select CODE_DATA_RELOCATION
	depends on PM

config TICKLESS_KERNEL
	default n

config TIMESLICE_SIZE
	default 10

config SYSTICK_USE_EXTERNAL_CLOCK
	bool
	default y

config IDLE_STACK_SIZE
	default 768

config MULTI_HEAP
	default y

config STACK_SENTINEL
	default y

rsource "Kconfig.defconfig.rtl87*"

endif # SOC_SERIES_RTL8752H
```

## soc/realtek/bee/rtl8752h/Kconfig.soc
```kconfig
# Copyright (c) 2024 Realtek Semiconductor Corp.
# SPDX-License-Identifier: Apache-2.0

config SOC_SERIES_RTL8752H
	bool
	select SOC_FAMILY_REALTEK_BEE

config SOC_SERIES
	default "rtl8752h" if SOC_SERIES_RTL8752H

config SOC_RTL8752HTV
	bool "SOC_RTL8752HTV"
	select SOC_SERIES_RTL8752H

config SOC_RTL8752HKF
	bool "SOC_RTL8752HKF"
	select SOC_SERIES_RTL8752H

config SOC
	default "rtl8752htv" if SOC_RTL8752HTV
	default "rtl8752hkf" if SOC_RTL8752HKF
```

## soc/realtek/bee/rtl87x2j/Kconfig
```kconfig
# Copyright (c) 2026, Realtek Semiconductor Corporation
# SPDX-License-Identifier: Apache-2.0

config SOC_SERIES_RTL87X2J
	select ARM
	select CPU_CORTEX_M33
	select CPU_HAS_FPU
	select CPU_HAS_ARM_MPU
	select CLOCK_CONTROL
	select GEN_ISR_TABLES
	select DYNAMIC_INTERRUPTS
	select ARMV8_M_DSP
	select XIP
	select THREAD_STACK_INFO
	select SOC_EARLY_INIT_HOOK
	select SOC_LATE_INIT_HOOK
	select USE_REALTEK_BEE_OS_INTERFACE
	select REALTEK_GRTC_TIMER
	select HAS_PM
	select HAS_POWEROFF
```

## soc/realtek/bee/rtl87x2j/Kconfig.defconfig.series
```kconfig
# Copyright (c) 2026, Realtek Semiconductor Corporation
# SPDX-License-Identifier: Apache-2.0

if SOC_SERIES_RTL87X2J

config NUM_IRQS
	default 91

config USE_DT_CODE_PARTITION
	default y

config SYS_CLOCK_HW_CYCLES_PER_SEC
	default 40000000

config SYS_CLOCK_TICKS_PER_SEC
	default 1000

config ARCH_HAS_CUSTOM_BUSY_WAIT
	default y

config TIMESLICE_SIZE
	default 10

config INIT_STACKS
	default y

config FPU
	default y if CPU_HAS_FPU

config IDLE_STACK_SIZE
	default 1024

if BT

config NUM_METAIRQ_PRIORITIES
	default 1

config MAIN_STACK_SIZE
	default 2048

config BT_BUF_ACL_TX_COUNT
	default 10

config BT_BUF_EVT_RX_COUNT
	default 16

endif # BT

endif # SOC_SERIES_RTL87X2J
```

## soc/realtek/bee/rtl87x2j/Kconfig.soc
```kconfig
# Copyright (c) 2026, Realtek Semiconductor Corporation
# SPDX-License-Identifier: Apache-2.0

config SOC_SERIES_RTL87X2J
	bool
	select SOC_FAMILY_REALTEK_BEE
	help
	  Enable support for Realtek RTL87x2J series

config SOC_RTL8762JTH
	bool
	select SOC_SERIES_RTL87X2J

config SOC_SERIES
	default "rtl87x2j" if SOC_SERIES_RTL87X2J

config SOC
	default "rtl8762jth" if SOC_RTL8762JTH

config PM_DEBUG_SNAPSHOT
	bool "RTL87x2J PM debug snapshot"
	help
	  Periodically log (every 10 s) the CPU WFI enter count, system
	  low-power mode enter count, and all IPs currently holding a
	  QActive request.
```

## subsys/usb/device/class/audio/Kconfig
```kconfig
# USB AUDIO configuration options

# Copyright (c) 2020 Nordic Semiconductor ASA
# SPDX-License-Identifier: Apache-2.0

config USB_DEVICE_AUDIO
	bool "USB Audio Device Class Driver"
	select EXPERIMENTAL
	select USB_COMPOSITE_DEVICE
	help
	  USB Audio Device Class driver.
	  Zephyr USB Audio Class is considered experimental
	  and not full.
	  Device configuration is done via dt overlay.

if USB_DEVICE_AUDIO

config USB_DEVICE_AUDIO_SAMPLE_RATE
	int "USB Audio sample rate (Hz)"
	default 16000
	help
	  Sample rate used to build the USB Audio Class descriptors
	  (tSamFreq and isochronous endpoint wMaxPacketSize). Must match
	  the rate the application drives the audio data path at.

module = USB_AUDIO
module-str = USB Audio
source "subsys/logging/Kconfig.template.log_config"

endif #USB_DEVICE_AUDIO
```

## tests/arch/arm/arm_sw_vector_relay/testcase.yaml
```yaml
tests:
  arch.arm.sw_vector_relay:
    filter: CONFIG_ARMV6_M_ARMV8_M_BASELINE or CONFIG_ARMV7_M_ARMV8_M_MAINLINE
    tags:
      - vector_relay
    arch_allow: arm
    integration_platforms:
      - mps2/an385
    platform_exclude:
      - rtl87x2g_evb
      - rtl8752h_evb
      - rtl8752h_dongle
```
