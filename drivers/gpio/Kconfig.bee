## drivers/gpio/Kconfig.bee
```kconfig
# Copyright (c) 2026 Realtek Semiconductor Corp.
# SPDX-License-Identifier: Apache-2.0

menuconfig GPIO_BEE
	bool "GPIO driver for Realtek Bee series SoC"
	default y
	select USE_HAL_REALTEK_GPIO
	depends on DT_HAS_REALTEK_BEE_GPIO_ENABLED
	help
	  This option enables the GPIO driver for Realtek Bee SoCs.

if GPIO_BEE
config BEE_GPIO_SUPPORT_BOTH_EDGE
	bool "Bee GPIO support both edge"
	default y if SOC_SERIES_RTL8752H
endif # GPIO_BEE

if GPIO_BEE && (SOC_RTL8762GTU || SOC_RTL8762GTH)
config BEE_USE_P6_2_AS_GPIOB21
	bool "Use P6_2 as GPIOB_21 on RTL8762GTU or RTL8762GTH"
	default n
	help
	  If true, use P6_2 as GPIOB_21 on RTL8762GTU or RTL8762GTH, else use P9_0.

config BEE_USE_P6_3_AS_GPIOB22
	bool "Use P6_3 as GPIOB_22 on RTL8762GTU or RTL8762GTH"
	default n
	help
	  If true, use P6_3 as GPIOB_22 on RTL8762GTU or RTL8762GTH, else use P9_1.

config BEE_USE_P6_5_AS_GPIOB24
	bool "Use P6_5 as GPIOB_24 on RTL8762GTU or RTL8762GTH"
	default n
	help
	  If true, use P6_5 as GPIOB_24 on RTL8762GTU or RTL8762GTH, else use P9_3.

config BEE_USE_P6_7_AS_GPIOB26
	bool "Use P6_7 as GPIOB_26 on RTL8762GTU or RTL8762GTH"
	default n
	help
	  If true, use P6_7 as GPIOB_26 on RTL8762GTU or RTL8762GTH, else use P9_5.

endif # GPIO_BEE && (SOC_RTL8762GTU || SOC_RTL8762GTH)

if GPIO_BEE && SOC_SERIES_RTL8752H

config BEE_USE_P4_1_AS_GPIO29
	bool "Use P4_1 as GPIO29 on RTL8752H"
	default n
	help
	  If true, use P4_1 as GPIO29 on RTL8752H, else use P3_5.

config BEE_USE_P4_2_AS_GPIO30
	bool "Use P4_2 as GPIO30 on RTL8752H"
	default n
	help
	  If true, use P4_2 as GPIO30 on RTL8752H, else use P3_6.

endif # GPIO_BEE && SOC_SERIES_RTL8752H
```

## drivers/i2c/Kconfig.bee
```kconfig
# Copyright (c) 2026, Realtek Semiconductor Corporation
# SPDX-License-Identifier: Apache-2.0

config I2C_BEE
	bool "Realtek Bee series I2C driver"
	default y
	depends on DT_HAS_REALTEK_BEE_I2C_ENABLED
	select HAL_REALTEK_BEE_I2C
	select PINCTRL
	select I2C_TRANSFER_TIMEOUT_SUPPORTED
	help
	  This option enables the I2C driver for Realtek Bee SoCs.

config I2C_BEE_BUS_RECOVERY
	bool "Bus recovery support"
	depends on I2C_BEE
	depends on GPIO_BEE
	default y if I2C_BUS_RECOVERY
	select I2C_BITBANG
	help
	  Enable I2C bus recovery on Realtek Bee SoCs by bit-banging the SCL/SDA
	  lines through GPIO. The GPIO pins are taken from the pads the current
	  default pinctrl state routes to SCL/SDA; they must not be in use by
	  anything else while the bus is recovered.
```

## drivers/i2c/Kconfig.rtl8752h
```kconfig
# RTL8752H i2c configuration

# Copyright(c) 2024, Realtek Semiconductor Corporation.
# SPDX-License-Identifier: Apache-2.0

config I2C_RTL8752H
	bool "RTL8752H I2C driver"
	default y
	depends on DT_HAS_REALTEK_RTL8752H_I2C_ENABLED
	select USE_HAL_REALTEK_I2C
	help
	  Enable the RTL8752H i2c driver.

config I2C_RTL8752H_BUS_RECOVERY
	bool "RTL8752H I2C bus recovery support"
	depends on I2C_RTL8752H
	select I2C_BITBANG
	help
	  Enable I2C bus recovery on RTL8752H by bit-banging the SCL/SDA lines
	  through GPIO. Requires GPIO to be enabled and the scl-gpios and
	  sda-gpios properties on the I2C node.
```

## drivers/i2s/Kconfig.bee
```kconfig
# Copyright (c) 2026, Realtek Semiconductor Corporation.
# SPDX-License-Identifier: Apache-2.0

config I2S_BEE
	bool "BEE family I2S driver"
	default y
	depends on DT_HAS_REALTEK_BEE_I2S_ENABLED
	select HAL_REALTEK_BEE_I2S
	select PINCTRL
	select DMA
	help
	  Enable I2S driver for Realtek BEE family SoCs.

if I2S_BEE

config I2S_BEE_TX
	bool "I2S BEE TX support"
	help
	  Enable I2S BEE TX (transmit) support.

config I2S_BEE_RX
	bool "I2S BEE RX support"
	help
	  Enable I2S BEE RX (receive) support.

config I2S_BEE_TX_BLOCK_COUNT
	int "Number of TX blocks / msg queue size"
	default 4
	help
	  Number of TX buffers / message queue size.

config I2S_BEE_RX_BLOCK_COUNT
	int "Number of RX blocks / msg queue size"
	default 4
	help
	  Number of RX buffers / message queue size.

config I2S_BEE_TX_BLOCK_SIZE_MAX
	int "Maximum TX block size (bytes)"
	depends on I2S_BEE_TX
	default 512
	help
	  Upper bound, in bytes, for the TX block size an application may
	  request through i2s_config. The driver reserves two ping-pong DMA
	  buffers of this size per instance; a configuration with a larger
	  block_size is rejected. Raise this if your application uses larger
	  I2S TX blocks.

config I2S_BEE_RX_BLOCK_SIZE_MAX
	int "Maximum RX block size (bytes)"
	depends on I2S_BEE_RX
	default 512
	help
	  Upper bound, in bytes, for the RX block size an application may
	  request through i2s_config. The driver reserves two ping-pong DMA
	  buffers of this size per instance; a configuration with a larger
	  block_size is rejected. Raise this if your application uses larger
	  I2S RX blocks.

endif # I2S_BEE
```

## drivers/i2s/Kconfig.rtl8752h
```kconfig
# RTL8752H i2s configuration

# Copyright(c) 2024, Realtek Semiconductor Corporation.
# SPDX-License-Identifier: Apache-2.0

menuconfig I2S_RTL8752H
	bool "RTL8752H MCU i2s controller driver"
	default y
	depends on DT_HAS_REALTEK_RTL8752H_I2S_ENABLED
	select DMA
	select USE_HAL_REALTEK_I2S
	help
	  Enable the RTL8752H i2s driver.

if I2S_RTL8752H

config I2S_RTL8752H_RX
	bool "Enable I2S RX"
	default n

if I2S_RTL8752H_RX

config I2S_RTL8752H_RX_BLOCK_COUNT
	int "RX queue length"
	default 4

endif # I2S_RTL8752H_RX

config I2S_RTL8752H_TX
	bool "Enable I2S TX"
	default n

if I2S_RTL8752H_TX

config I2S_RTL8752H_TX_BLOCK_COUNT
	int "TX queue length"
	default 4

endif # I2S_RTL8752H_TX

endif # I2S_RTL8752H
```

## drivers/i2s/Kconfig.rtl87x2g
```kconfig
# RTL87X2G i2s configuration

# Copyright(c) 2025, Realtek Semiconductor Corporation.
# SPDX-License-Identifier: Apache-2.0

menuconfig I2S_RTL87X2G
	bool "RTL87X2G MCU i2s controller driver"
	default y
	depends on DT_HAS_REALTEK_RTL87X2G_I2S_ENABLED
	select DMA
	select USE_HAL_REALTEK_I2S
	help
	  Enable the rtl87x2g i2s driver.

if I2S_RTL87X2G

config I2S_RTL87X2G_RX
	bool "I2S RX"
	default n

if I2S_RTL87X2G_RX

config I2S_RTL87X2G_RX_BLOCK_COUNT
	int "RX queue length"
	default 4

endif # I2S_RTL87X2G_RX

config I2S_RTL87X2G_TX
	bool "I2S TX"
	default n

if I2S_RTL87X2G_TX

config I2S_RTL87X2G_TX_BLOCK_COUNT
	int "TX queue length"
	default 4

endif # I2S_RTL87X2G_TX

endif # I2S_RTL87X2G
```

## drivers/ieee802154/Kconfig.bee
```kconfig
config IEEE802154_REALTEK_BEE
	bool "bee series IEEE 802.15.4 Driver"
	default y
	depends on DT_HAS_REALTEK_BEE_IEEE802154_ENABLED
```

## drivers/input/Kconfig.bee_kscan
```kconfig
# BEE kscan configuration

# Copyright(c) 2025, Realtek Semiconductor Corporation.
# SPDX-License-Identifier: Apache-2.0

config INPUT_BEE_KSCAN
	bool "BEE MCU kscan driver"
	default n
	depends on DT_HAS_REALTEK_BEE_KSCAN_ENABLED
	select USE_HAL_REALTEK_KEYSCAN
	help
	  Enable the BEE kscan driver.

if INPUT_BEE_KSCAN
config BEE_INPUT_KSCAN_MAX_ROW_SIZE
	int "Max row size for bee kscan"
	default 12
	help
	  Max row size for bee kscan.

config BEE_INPUT_KSCAN_MAX_COL_SIZE
	int "Max column size for bee kscan"
	default 20
	help
	  Max column size for bee kscan.

config BEE_INPUT_KSCAN_GHOST_KEY_FILTER
	bool "Ghost key filter for bee kscan"
	default y
	help
	  Ghost key filter for bee kscan.

config BEE_INPUT_KSCAN_AUTOSCAN_MODE
	bool "Config scanmode for bee kscan"
	default y
	help
	  default is autoscan, else is manual scan.

if !BEE_INPUT_KSCAN_AUTOSCAN_MODE
config BEE_INPUT_KSCAN_RELEASE_WAKEUP
	bool "Wakeup system when key release"
	default n
	help
	  Wakeup system when key release using manual mode.
	  If enabled, When entering DLPS during pressing the key, the row pins
	  will be configured as pull-up. This results in leakage current through
	  the pull-up resistor during key press, but the system will wake up
	  immediately after releasing the key.
	  If disabled, When entering DLPS by pressing the key, the row pins will
	  be configured as pull-down. This eliminates leakage current during key
	  press, but the system can only wake up after a timeout period once the
	  key is released, followed by a scan to detect key status.

endif # BEE_INPUT_KSCAN_AUTOSCAN_MODE

endif # INPUT_BEE_KSCAN
```

## drivers/input/Kconfig.rtl8752h_kscan
```kconfig
# RTL8752H kscan configuration

# Copyright(c) 2024, Realtek Semiconductor Corporation.
# SPDX-License-Identifier: Apache-2.0

config INPUT_RTL8752H_KSCAN
	bool "RTL8752H MCU kscan driver"
	default n
	depends on DT_HAS_REALTEK_RTL8752H_KSCAN_ENABLED
	select USE_HAL_REALTEK_KEYSCAN
	help
	  Enable the RTL8752H kscan driver.

if INPUT_RTL8752H_KSCAN
config RTL8752H_INPUT_KEYSCAN_MAX_ROW_SIZE
	int "Max row size for rtl8752h kscan"
	default 12
	help
	  Max row size for rtl8752h kscan.

config RTL8752H_INPUT_KEYSCAN_MAX_COL_SIZE
	int "Max column size for rtl8752h kscan"
	default 20
	help
	  Max column size for rtl8752h kscan.

config RTL8752H_INPUT_KEYSCAN_GHOST_KEY_FILTER
	bool "Ghost key filter for rtl8752h kscan"
	default y
	help
	  Ghost key filter for rtl8752h kscan.

config RTL8752H_INPUT_KEYSCAN_AUTOSCAN_MODE
	bool "Config scanmode for rtl8752h kscan"
	default y
	help
	  default is autoscan, else is manual scan.

if !RTL8752H_INPUT_KEYSCAN_AUTOSCAN_MODE
config RTL8752H_KEYSCAN_MANUAL_SCAN_INTERVAL_MSEC
	int "Scan Interval when using manual mode"
	default 50
	help
	  Scan Interval when using manual mode.

endif # RTL8752H_INPUT_KEYSCAN_AUTOSCAN_MODE

endif # INPUT_RTL8752H_KSCAN
```

## drivers/ir/Kconfig
```kconfig
# IR driver configuration options

# Copyright (c) 2026, Realtek Semiconductor Corporation
# SPDX-License-Identifier: Apache-2.0

menuconfig IR
	bool "IR drivers"
	help
	  Enable options for ir drivers.

if IR

comment "Capabilities"
config IR_INIT_PRIORITY
	int "IR init priority"
	default KERNEL_INIT_PRIORITY_DEVICE
	help
	  IR driver device initialization priority.

module = IR
module-str = ir
source "subsys/logging/Kconfig.template.log_config"

comment "IR Drivers"

source "drivers/ir/Kconfig.bee"
endif # IR
```

## drivers/ir/Kconfig.bee
```kconfig
# Copyright (c) 2026, Realtek Semiconductor Corporation
# SPDX-License-Identifier: Apache-2.0

config IR_BEE
	bool "IR driver for Realtek Bee series SoC"
	default y
	depends on DT_HAS_REALTEK_BEE_IR_ENABLED
	select HAL_REALTEK_BEE_IR
	select PINCTRL
	help
	  This option enables the IR driver for Realtek Bee SoCs.
```

## drivers/ir/Kconfig.rtl8752h
```kconfig
# RTL8752H ir configuration

# Copyright(c) 2024, Realtek Semiconductor Corporation.
# SPDX-License-Identifier: Apache-2.0

config IR_RTL8752H
	bool "RTL8752H MCU ir driver"
	default y
	depends on DT_HAS_REALTEK_RTL8752H_IR_ENABLED
	select USE_HAL_REALTEK_IR

	help
	  Enable the RTL8752H ir driver.
```

## drivers/kscan/Kconfig.bee
```kconfig
# Copyright (c) 2026 Realtek Semiconductor Corp.
# SPDX-License-Identifier: Apache-2.0

config KSCAN_BEE
	bool "kscan driver for Realtek Bee series SoC"
	default y
	depends on DT_HAS_REALTEK_BEE_KSCAN_ENABLED
	depends on !INPUT_BEE_KSCAN
	select USE_HAL_REALTEK_KEYSCAN
	help
	  This option enables the KSCAN driver for Realtek Bee SoCs.

if KSCAN_BEE
config BEE_KSCAN_MAX_ROW_SIZE
	int "Max row size for bee kscan"
	default 12
	help
	  Max row size for BEE kscan.

config BEE_KSCAN_MAX_COL_SIZE
	int "Max column size for BEE kscan"
	default 20
	help
	  Max column size for BEE kscan.

config BEE_KSCAN_GHOST_KEY_FILTER
	bool "Ghost key filter for BEE kscan"
	default y
	help
	  Ghost key filter for BEE kscan.

config BEE_KSCAN_AUTOSCAN_MODE
	bool "Config scanmode for BEE kscan"
	default y
	help
	  default is autoscan, else is manual scan.

if !BEE_KSCAN_AUTOSCAN_MODE
config BEE_KSCAN_RELEASE_WAKEUP
	bool "Wakeup system when key release"
	default n
	help
	  Wakeup system when key release using manual mode.
	  If enabled, When entering DLPS during pressing the key, the row pins
	  will be configured as pull-up. This results in leakage current through
	  the pull-up resistor during key press, but the system will wake up
	  immediately after releasing the key.
	  If disabled, When entering DLPS by pressing the key, the row pins will
	  be configured as pull-down. This eliminates leakage current during key
	  press, but the system can only wake up after a timeout period once the
	  key is released, followed by a scan to detect key status.

endif # BEE_KSCAN_AUTOSCAN_MODE

endif # KSCAN_BEE
```

## drivers/pinctrl/Kconfig.bee
```kconfig
# Copyright (c) 2026 Realtek Semiconductor Corp.
# SPDX-License-Identifier: Apache-2.0

config PINCTRL_BEE
	bool "Pin controller driver for Realtek Bee series SoC"
	default y
	depends on DT_HAS_REALTEK_BEE_PINCTRL_ENABLED
	select USE_HAL_REALTEK_PINMUX
	help
	  This option enables the pin controller driver for Realtek Bee SoCs.
```

## drivers/pwm/Kconfig.bee
```kconfig
# Copyright (c) 2026, Realtek Semiconductor Corporation
# SPDX-License-Identifier: Apache-2.0

config PWM_BEE
	bool "Realtek Bee series PWM driver"
	default y
	depends on DT_HAS_REALTEK_BEE_PWM_ENABLED
	select HAL_REALTEK_BEE_TIM if DT_HAS_REALTEK_BEE_BASIC_TIMER_ENABLED
	select HAL_REALTEK_BEE_ENHTIM if DT_HAS_REALTEK_BEE_ENHANCED_TIMER_ENABLED
	select PINCTRL
	help
	  This option enables the PWM driver for Realtek Bee SoCs.

config PWM_BEE_LPPWM
	bool "Realtek Bee low-power PWM (LPPWM) driver"
	default y
	depends on DT_HAS_REALTEK_BEE_LPPWM_ENABLED
	select HAL_REALTEK_BEE_PWM
	select PINCTRL
	help
	  This option enables the always-on low-power PWM (LPPWM) driver. The
	  LPPWM keeps toggling its single output channel while the SoC is in a
	  low-power sleep state.
```

## drivers/rtc/Kconfig.bee
```kconfig
# Copyright (c) 2026 Realtek Semiconductor Corp.
# SPDX-License-Identifier: Apache-2.0

config RTC_BEE
	bool "RTC driver for Realtek Bee series SoC"
	default n
	depends on DT_HAS_REALTEK_BEE_RTC_ENABLED
	select USE_HAL_REALTEK_RTC
	help
	  This option enables the RTC driver for Realtek Bee SoCs.
```

## drivers/sdhc/Kconfig.bee
```kconfig
# Copyright (c) 2026 Realtek Semiconductor Corp.
# SPDX-License-Identifier: Apache-2.0

config SDHC_BEE
	bool "SDHC driver for Realtek Bee series SoC"
	default y
	depends on DT_HAS_REALTEK_BEE_SDHC_ENABLED
	select HAL_REALTEK_BEE_SDHC
	select PINCTRL
	select SDHC_SUPPORTS_NATIVE_MODE
	help
	  This option enables the SDHC driver for Realtek Bee SoCs.

if SDHC_BEE
config SDHC_BUFFER_ALIGNMENT
	default 4

config SDHC_BEE_ISR_TRACE
	bool "Trace SDHC interrupts for debugging"
	help
	  Record every SDHC interrupt (opcode, RINTSTS, IDSTS) in a small RAM
	  ring buffer and, when an interrupt carries an error bit, dump the whole
	  ring. This exposes the exact status sequence leading up to a transfer
	  error. Intended for driver bring-up/debugging only; leave disabled in
	  production.
endif
```

## drivers/sensor/aon_qdec_bee/Kconfig
```kconfig
# Copyright(c) 2025, Realtek Semiconductor Corporation.
# SPDX-License-Identifier: Apache-2.0

config AON_QDEC_BEE
	bool "BEE MCU aon qdec driver"
	default y
	depends on DT_HAS_REALTEK_BEE_AON_QDEC_ENABLED
	select USE_HAL_REALTEK_AON_QDEC
	help
	  Enable support for aon_qdec driver for BEE MCU series.
```

## drivers/sensor/qdec_bee/Kconfig
```kconfig
# Copyright(c) 2025, Realtek Semiconductor Corporation.
# SPDX-License-Identifier: Apache-2.0

config QDEC_BEE
	bool "BEE MCU qdec driver"
	default y
	depends on DT_HAS_REALTEK_BEE_QDEC_ENABLED
	select USE_HAL_REALTEK_QDEC
	help
	  Enable support for qdec driver for BEE MCU series.

if QDEC_BEE

config BEE_QDEC_X_AXIS_ENABLE
	bool "x axis for bee qdec"
	default y
	help
	  If true, enable x aix for bee qdec.

config BEE_QDEC_Y_AXIS_ENABLE
	bool "y axis for bee qdec"
	default n
	help
	  If true, enable y aix for bee qdec.

config BEE_QDEC_Z_AXIS_ENABLE
	bool "z axis for bee qdec"
	default n
	help
	  If true, enable z aix for bee qdec.

endif # QDEC_BEE
```
