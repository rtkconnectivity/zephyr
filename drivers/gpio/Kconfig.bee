## drivers/serial/Kconfig.bee
```kconfig
# Copyright (c) 2026, Realtek Semiconductor Corporation
# SPDX-License-Identifier: Apache-2.0

config UART_BEE
	bool "Realtek Bee series UART driver"
	default y
	depends on DT_HAS_REALTEK_BEE_UART_ENABLED
	select HAL_REALTEK_BEE_UART
	select SERIAL_HAS_DRIVER
	select SERIAL_SUPPORT_INTERRUPT
	select PINCTRL
	select SERIAL_SUPPORT_ASYNC \
		if DT_HAS_REALTEK_BEE_DMA_ENABLED
	select DMA if UART_ASYNC_API
	help
	  This option enables the UART driver for Realtek Bee SoCs.

config UART_BEE_KEEP_ACTIVE_TIMEOUT_MSEC
	int "Milliseconds to keep the UART active after it woke the system up"
	depends on PM_DEVICE
	default 5000
	help
	  Keep a UART powered for this long after its RX pad woke the system
	  up, so that the incoming frame is received instead of dropped. Set
	  to 0 to let the UART suspend again right away.

	  This needs a devicetree node that is a wakeup-source and whose sleep
	  pinctrl state configures a pin for wakeup.

	  Note: This does not mean that the system will sleep immediately
	  after timeout, it depends on other check status.
```

## drivers/spi/Kconfig.bee
```kconfig
# Copyright (c) 2026 Realtek Semiconductor Corp.
# SPDX-License-Identifier: Apache-2.0

config SPI_BEE
	bool "SPI driver for Realtek Bee series SoC"
	default y
	depends on DT_HAS_REALTEK_BEE_SPI_ENABLED
	select USE_HAL_REALTEK_SPI
	help
	  This option enables the SPI driver for Realtek Bee SoCs.

if SPI_BEE

config SPI_BEE_INTERRUPT
	bool "BEE MCU SPI Interrupt Support"
	default y if SPI_ASYNC
	default y if SPI_BEE_DMA
	help
	  Enable the interrupt driven mode for SPI instances

config SPI_BEE_DMA
	bool "BEE MCU SPI DMA Support"
	select DMA
	select SPI_BEE_INTERRUPT
	select USE_HAL_REALTEK_DMA
	help
	  Use the DMA for SPI transfer
	  that enable dma channels in their device tree node.

endif # SPI_BEE
```

## drivers/timer/Kconfig.realtek_grtc_timer
```kconfig
# Copyright (c) 2026 Realtek Semiconductor Corp.
# SPDX-License-Identifier: Apache-2.0

config REALTEK_GRTC_TIMER
	bool "Realtek GRTC timer"
	default n
	depends on DT_HAS_REALTEK_GRTC_TIMER_ENABLED
	select TICKLESS_CAPABLE
	select TIMER_HAS_64BIT_CYCLE_COUNTER
	select HAL_REALTEK_BEE_GRTC
	help
	  This module implements a kernel device driver for the Realtek GRTC timer,
	  and provides the standard "system clock driver" interfaces.
```

## drivers/usb/udc/Kconfig.bee
```kconfig
# Copyright (c) 2026 Realtek Semiconductor Corp.
# SPDX-License-Identifier: Apache-2.0

config UDC_BEE
	bool "UDC driver for Realtek Bee series SoC"
	default y
	depends on DT_HAS_REALTEK_BEE_UDC_ENABLED
	select USE_HAL_REALTEK_USB

	help
	  This option enables the UDC driver for Realtek Bee SoCs.
```

## drivers/watchdog/Kconfig.rtl8752h
```kconfig
# Copyright (c) 2025 Realtek Semiconductor Corp.
# SPDX-License-Identifier: Apache-2.0

config AON_WDT_RTL8752H
	bool "RTL8752H AON Watchdog Timer driver"
	default y
	depends on DT_HAS_REALTEK_RTL8752H_AON_WDT_ENABLED
	select USE_HAL_REALTEK_AON_WDT
	help
	  Enable the RTL8752H aon wdg timer driver.

config CORE_WDT_RTL8752H
	bool "RTL8752H Core Watchdog Timer driver"
	default y
	depends on DT_HAS_REALTEK_RTL8752H_CORE_WDT_ENABLED
	depends on !PM
	select USE_HAL_REALTEK_CORE_WDT
	help
	  Enable the RTL8752H core wdg timer driver. It's not
	  supported with (CONFIG_PM=y)
```

## dts/bindings/adc/realtek,bee-adc.yaml
```yaml
# Copyright(c) 2026, Realtek Semiconductor Corporation.
# SPDX-License-Identifier: Apache-2.0

description: |
  Bee ADC controller.
  The RTL87X2G ADC has 9 channels. Pinctrl must be configured as "SW_MODE" while using ADC.
  P2_0 to P2_7 could be configured as ADC sampling pins, corresponding to ADC channel 0 to 7.
  The last adc channel(channel8) is internal vbat channel, which does not need a external pin
  to sample.

  The RTL8752H ADC has 8 channels. Pinctrl must be configured as "SW_MODE" while using ADC.
  P2_0 to P2_5 and P2_7 could be configured as ADC sampling pins,
  corresponding to ADC channel 0 to 5 and 7.
  The last adc channel(channel8) is internal vbat channel, which does not need a external pin
  to sample.
  Notes: adc channel 6 is not supported on RTL8752H!!!

  Example of devicetree configuration.

  &adc {
    pinctrl-0 = <&adc_default>;
    pinctrl-names = "default";
    #address-cells = <1>;
    #size-cells = <0>;
    status = "okay";
    channel@0 {
        reg = <0>;
        zephyr,gain = "ADC_GAIN_1";
        zephyr,reference = "ADC_REF_INTERNAL";
        zephyr,acquisition-time = <ADC_ACQ_TIME_DEFAULT>;
        zephyr,resolution = <12>;
    };

    channel@8 {
        reg = <8>;
        zephyr,gain = "ADC_GAIN_1";
        zephyr,reference = "ADC_REF_INTERNAL";
        zephyr,acquisition-time = <ADC_ACQ_TIME_DEFAULT>;
        zephyr,resolution = <12>;
    };
  };

  &pinctrl {
    adc_default: adc_default {
        group1 {
            psels = <BEE_PSEL(SW_MODE, P2_0, DIR_IN, DRV_LOW, PULL_DOWN)>;
        };
    };
  };

compatible: "realtek,bee-adc"

include: [adc-controller.yaml, pinctrl-device.yaml]

properties:
  reg:
    required: true

  clocks:
    required: true

  channels:
    type: int
    description: Number of external channels
    required: true

  interrupts:
    required: true

  "#io-channel-cells":
    const: 1

  pinctrl-0:
    required: true

  pinctrl-names:
    required: true

  is-bypass-mode:
    type: int
    default: 0
    description: |
      This is a channel map to configure bypass/divide mode for each adc channel.
      For example, configure 0x05 means channel0 and channel2 are configured as bypass mode,
      and other channels are configured as divide mode by default.
      In "divide mode" the ADC range is 0 to 3.3V.
      In "bypass mode" the ADC range is 0 to 0.9V.

io-channel-cells:
  - input
```
