## drivers/counter/Kconfig.bee_timer
```kconfig
# Copyright (c) 2026, Realtek Semiconductor Corporation
# SPDX-License-Identifier: Apache-2.0

config COUNTER_BEE_TIMER
	bool "Realtek Bee series counter timer driver"
	default y
	depends on DT_HAS_REALTEK_BEE_COUNTER_TIMER_ENABLED
	select HAL_REALTEK_BEE_TIM if DT_HAS_REALTEK_BEE_BASIC_TIMER_ENABLED
	select HAL_REALTEK_BEE_ENHTIM if DT_HAS_REALTEK_BEE_ENHANCED_TIMER_ENABLED
	select COUNTER_SUPPORTS_CAPTURE
	select PINCTRL if COUNTER_CAPTURE
	help
	  This option enables the counter timer driver for Realtek Bee SoCs.

	  The driver supports the counter capture API on timers with a GPIO
	  latch count, with the trigger pad selected by the pinctrl-0 property
	  of the counter node. One capture channel (0) is provided.
```

## dts/bindings/can/realtek,bee-can.yaml
```yaml
# Copyright (c) 2026, Realtek Semiconductor Corporation
# SPDX-License-Identifier: Apache-2.0

description: |
  Bee CAN controller.

  pinctrl-0 can be left out when the controller only runs in internal
  loopback mode and needs no pads.

compatible: "realtek,bee-can"

include: [can-controller.yaml, pinctrl-device.yaml]

properties:
  reg:
    required: true

  interrupts:
    required: true

  clocks:
    required: true

  rx-timestamp-prescaler:
    type: int
    description: |
      Prescaler value for computing the RX timestamps of received frames.
      The timestamp counter is derived from the CAN source clock divided by this value.
      A value of 1 means the timestamp counter runs at the CAN source clock rate.
    min: 1
    max: 256
```

## dts/bindings/counter/realtek,bee-counter-timer.yaml
```yaml
# Copyright (c) 2026, Realtek Semiconductor Corporation
# SPDX-License-Identifier: Apache-2.0

description: Realtek Bee Timer implemented as Counter

compatible: "realtek,bee-counter-timer"

include: [base.yaml, pinctrl-device.yaml]

properties:
  pinctrl-0:
    description: |
      Selects the pad that triggers the GPIO latch count, used as counter
      capture channel 0. The default state must hold exactly one pad, and
      the pad must have its input enabled, e.g. BEE_PSEL(SW_MODE, P0_1)
      with output-disable. The pad number is read from the default state
      on every counter_capture_configure() call, so the trigger pad can be
      switched at runtime with pinctrl_update_states().
      Capture is unsupported on counters without this property.
      Only the following timers implement the GPIO latch count:
      For RTL87X2J series: TIMER2_CH0.
      For RTL87X2G series: all enhanced timers.
      For RTL8752H series: all enhanced timers.
      On RTL87X2G and RTL8752H series the GPIO latch trigger is routed to
      one enhanced timer at a time, so only one timer should use capture.

  latch-debounce:
    type: boolean
    description: |
      Enable the hardware debounce filter on the capture trigger pad.
      Only supported on RTL87X2J series.

  latch-debounce-div:
    type: int
    default: 1
    description: |
      Division factor of the 32 kHz latch debounce clock.
      Only supported on RTL87X2J series.
    enum: [1, 2, 4, 8, 16, 32, 40, 64]

  latch-debounce-count:
    type: int
    default: 1
    description: |
      Latch debounce count limit in debounce clock cycles (0..65535).
      Only supported on RTL87X2J series.
```

## tests/boards/realtek/bee/ot-cli/testcase.yaml
```yaml
tests:
  boards.realtek.ot-cli:
    tags: realtek_ot-cli
    platform_allow:
      - rtl87x2g_evb_a/rtl8762gkh
```
