## drivers/input/Kconfig.rtl87x2g_kscan
```kconfig
# RTL87X2G kscan configuration

# Copyright(c) 2024, Realtek Semiconductor Corporation.
# SPDX-License-Identifier: Apache-2.0

config INPUT_RTL87X2G_KSCAN
	bool "RTL87X2G MCU kscan driver"
	default n
	depends on DT_HAS_REALTEK_RTL87X2G_KSCAN_ENABLED
	select USE_HAL_REALTEK_KEYSCAN
	help
	  Enable the RTL87X2G kscan driver.

if INPUT_RTL87X2G_KSCAN
config RTL87X2G_KEYSCAN_MAX_ROW_SIZE
	int "Max row size for rtl87x2g kscan"
	default 12
	help
	  Max row size for rtl87x2g kscan.

config RTL87X2G_KEYSCAN_MAX_COL_SIZE
	int "Max column size for rtl87x2g kscan"
	default 20
	help
	  Max column size for rtl87x2g kscan.

config RTL87X2G_KEYSCAN_GHOST_KEY_FILTER
	bool "Ghost key filter for rtl87x2g kscan"
	default y
	help
	  Ghost key filter for rtl87x2g kscan.

endif # INPUT_RTL87X2G_KSCAN
```

## drivers/kscan/Kconfig.rtl8752h
```kconfig
# RTL8752H kscan configuration

# Copyright(c) 2024, Realtek Semiconductor Corporation.
# SPDX-License-Identifier: Apache-2.0

config KSCAN_RTL8752H
	bool "RTL8752H MCU kscan driver"
	default y
	depends on DT_HAS_REALTEK_RTL8752H_KSCAN_ENABLED
	select USE_HAL_REALTEK_KEYSCAN
	help
	  Enable the RTL8752H kscan driver.

if KSCAN_RTL8752H
config RTL8752H_KEYSCAN_MAX_ROW_SIZE
	int "Max row size for rtl8762g kscan"
	default 12
	help
	  Max row size for rtl8762g kscan.

config RTL8752H_KEYSCAN_MAX_COL_SIZE
	int "Max column size for rtl8762g kscan"
	default 20
	help
	  Max column size for rtl8762g kscan.

config RTL8752H_KEYSCAN_GHOST_KEY_FILTER
	bool "Ghost key filter for rtl8762g kscan"
	default y
	help
	  Ghost key filter for rtl8762g kscan.

endif # KSCAN_RTL8752H
```

## drivers/kscan/Kconfig.rtl87x2g
```kconfig
# RTL87X2G kscan configuration

# Copyright(c) 2024, Realtek Semiconductor Corporation.
# SPDX-License-Identifier: Apache-2.0

config KSCAN_RTL87X2G
	bool "RTL87X2G MCU kscan driver"
	default y
	depends on DT_HAS_REALTEK_RTL87X2G_KSCAN_ENABLED
	depends on !INPUT_RTL87X2G_KSCAN
	select USE_HAL_REALTEK_KEYSCAN
	help
	  Enable the RTL87X2G kscan driver.

if KSCAN_RTL87X2G
config RTL87X2G_KEYSCAN_MAX_ROW_SIZE
	int "Max row size for rtl87x2g kscan"
	default 12
	help
	  Max row size for rtl87x2g kscan.

config RTL87X2G_KEYSCAN_MAX_COL_SIZE
	int "Max column size for rtl87x2g kscan"
	default 20
	help
	  Max column size for rtl87x2g kscan.

config RTL87X2G_KEYSCAN_GHOST_KEY_FILTER
	bool "Ghost key filter for rtl87x2g kscan"
	default y
	help
	  Ghost key filter for rtl87x2g kscan.

config RTL87X2G_KEYSCAN_SCAN_MODE
	bool "Config scanmode for rtl87x2g kscan"
	default y
	help
	  default is autoscan, else is manual scan.

if !RTL87X2G_KEYSCAN_SCAN_MODE
config RTL87X2G_KEYSCAN_MANUAL_SEL
	int "Setting the Trigger Method"
	default 0
	help
	  0 is bit trigger 1 is key trigger.

endif # RTL87X2G_KEYSCAN_SCAN_MODE

if !RTL87X2G_KEYSCAN_SCAN_MODE
config RTL87X2G_KEYSCAN_MANUAL_SCAN_INTERVAL_MSEC
	int "Scan Interval when using manual mode"
	default 50
	help
	  Scan Interval when using manual mode.

endif # RTL87X2G_KEYSCAN_SCAN_MODE

endif # KSCAN_RTL87X2G
```

## drivers/pinctrl/Kconfig.rtl8752h
```kconfig
# RTL8752H PINCTRL configuration

# Copyright(c) 2024, Realtek Semiconductor Corporation.
# SPDX-License-Identifier: Apache-2.0

config PINCTRL_RTL8752H
	bool "RTL8752H pin controller driver"
	default y
	depends on DT_HAS_REALTEK_RTL8752H_PINCTRL_ENABLED
	select USE_HAL_REALTEK_PINMUX
	help
	  Enable the RTL8752H pin controller driver.
```

## drivers/ppt/Kconfig
```kconfig
# PPT configuration options

# Copyright (c) 2019 Intel Corporation
# SPDX-License-Identifier: Apache-2.0

menuconfig PPT
	bool "PPT drivers"
	help
	  Include PPT drivers in system config.
```

## drivers/pwm/Kconfig.rtl8752h
```kconfig
# RTL8752H pwm configuration

# Copyright(c) 2020, Realtek Semiconductor Corporation.
# SPDX-License-Identifier: Apache-2.0

config PWM_RTL8752H
	bool "RTL8752H PWM driver"
	default y
	depends on DT_HAS_REALTEK_RTL8752H_PWM_ENABLED
	select USE_HAL_REALTEK_TIM
	select USE_HAL_REALTEK_ENHTIM
	help
	  Enable the RTL8752H pwm driver.
```

## drivers/pwm/Kconfig.rtl87x2g
```kconfig
# RTL87X2G pwm configuration

# Copyright(c) 2020, Realtek Semiconductor Corporation.
# SPDX-License-Identifier: Apache-2.0

config PWM_RTL87X2G
	bool "RTL87X2G PWM driver"
	default y
	depends on DT_HAS_REALTEK_RTL87X2G_PWM_ENABLED
	select USE_HAL_REALTEK_TIM
	select USE_HAL_REALTEK_ENHTIM
	help
	  Enable the RTL87X2G pwm driver.
```

## drivers/rtc/Kconfig.rtl8752h
```kconfig
# RTL8752H rtc configuration

# Copyright(c) 2024, Realtek Semiconductor Corporation.
# SPDX-License-Identifier: Apache-2.0

config RTC_RTL8752H
	bool "RTL8752H RTC driver"
	default n
	depends on DT_HAS_REALTEK_RTL8752H_RTC_ENABLED
	select USE_HAL_REALTEK_RTC
	help
	  Enable the RTL8752H rtc driver.
```

## drivers/rtc/Kconfig.rtl87x2g
```kconfig
# RTL87X2G rtc configuration

# Copyright(c) 2020, Realtek Semiconductor Corporation.
# SPDX-License-Identifier: Apache-2.0

config RTC_RTL87X2G
	bool "RTL87X2G RTC driver"
	default n
	depends on DT_HAS_REALTEK_RTL87X2G_RTC_ENABLED
	select USE_HAL_REALTEK_RTC
	help
	  Enable the RTL87X2G rtc driver.
```

## drivers/sensor/aon_qdec_rtl87x2g/Kconfig
```kconfig
# Copyright(c) 2020, Realtek Semiconductor Corporation.
# SPDX-License-Identifier: Apache-2.0

config AON_QDEC_RTL87X2G
	bool "RTL87X2G MCU aon qdec driver"
	default y
	depends on DT_HAS_REALTEK_RTL87X2G_AON_QDEC_ENABLED
	select USE_HAL_REALTEK_AON_QDEC
	help
	  Enable support for aon qdec driver for RTL87X2G MCU series.
```

## drivers/serial/Kconfig.rtl8752h
```kconfig
# RTL8752H uart configuration

# Copyright(c) 2024, Realtek Semiconductor Corporation.
# SPDX-License-Identifier: Apache-2.0

config UART_RTL8752H
	bool "RTL8752H MCU serial driver"
	default y
	depends on DT_HAS_REALTEK_RTL8752H_UART_ENABLED
	select USE_HAL_REALTEK_UART
	select SERIAL_HAS_DRIVER
	select SERIAL_SUPPORT_INTERRUPT
	# the ASYNC implementation requires a DMA controller
	select SERIAL_SUPPORT_ASYNC \
		if DT_HAS_REALTEK_RTL8752H_DMA_ENABLED
	select DMA if UART_ASYNC_API

	help
	  Enable the RTL8752H uart driver.
```

## drivers/serial/Kconfig.rtl87x2g
```kconfig
# RTL87X2G uart configuration

# Copyright(c) 2020, Realtek Semiconductor Corporation.
# SPDX-License-Identifier: Apache-2.0

config UART_RTL87X2G
	bool "RTL87X2G MCU serial driver"
	default y
	depends on DT_HAS_REALTEK_RTL87X2G_UART_ENABLED
	select USE_HAL_REALTEK_UART
	select SERIAL_HAS_DRIVER
	select SERIAL_SUPPORT_INTERRUPT
	# the ASYNC implementation requires a DMA controller
	select SERIAL_SUPPORT_ASYNC \
		if DT_HAS_REALTEK_RTL87X2G_DMA_ENABLED
	select DMA if UART_ASYNC_API

	help
	  Enable the RTL87X2G uart driver.
```

## drivers/spi/Kconfig.rtl8752h
```kconfig
# RTL8752H spi configuration

# Copyright(c) 2024, Realtek Semiconductor Corporation.
# SPDX-License-Identifier: Apache-2.0

config SPI_RTL8752H
	bool "RTL8752H SPI driver"
	default y
	depends on DT_HAS_REALTEK_RTL8752H_SPI_ENABLED
	select USE_HAL_REALTEK_SPI
	help
	  Enables the RTL8752H spi driver.

if SPI_RTL8752H

config SPI_RTL8752H_INTERRUPT
	bool "RTL8752H MCU SPI Interrupt Support"
	default y if SPI_ASYNC
	default y if SPI_RTL8752H_DMA
	help
	  Enable the interrupt driven mode for SPI instances

config SPI_RTL8752H_DMA
	bool "RTL8752H MCU SPI DMA Support"
	select DMA
	select SPI_RTL8752H_INTERRUPT
	select USE_HAL_REALTEK_DMA
	help
	  Use the DMA for SPI transfer
	  that enable dma channels in their device tree node.

endif # SPI_RTL8752H
```

## drivers/spi/Kconfig.rtl87x2g
```kconfig
# RTL87X2G spi configuration

# Copyright(c) 2020, Realtek Semiconductor Corporation.
# SPDX-License-Identifier: Apache-2.0

config SPI_RTL87X2G
	bool "RTL87X2G SPI driver"
	default y
	depends on DT_HAS_REALTEK_RTL87X2G_SPI_ENABLED
	select USE_HAL_REALTEK_SPI
	help
	  Enables the RTL87X2G spi driver.

if SPI_RTL87X2G

config SPI_RTL87X2G_INTERRUPT
	bool "RTL87X2G MCU SPI Interrupt Support"
	default y if SPI_ASYNC
	default y if SPI_RTL87X2G_DMA
	help
	  Enable the interrupt driven mode for SPI instances

config SPI_RTL87X2G_DMA
	bool "RTL87X2G MCU SPI DMA Support"
	select DMA
	select SPI_RTL87X2G_INTERRUPT
	select USE_HAL_REALTEK_DMA
	help
	  Use the DMA for SPI transfer
	  that enable dma channels in their device tree node.

endif # SPI_RTL87X2G
```

## drivers/usb/udc/Kconfig.rtl87x2g
```kconfig
# Copyright(c) 2024, Realtek Semiconductor Corporation.
# SPDX-License-Identifier: Apache-2.0

config UDC_RTL87X2G
	bool "RTL87X2G MCU udc driver"
	default y
	depends on DT_HAS_REALTEK_RTL87X2G_UDC_ENABLED
	select USE_HAL_REALTEK_USB

	help
	  Enables the RTL87X2G usb driver.
```

## drivers/watchdog/Kconfig.rtl87x2g
```kconfig
# RTL87X2G wdt configuration

# Copyright(c) 2020, Realtek Semiconductor Corporation.
# SPDX-License-Identifier: Apache-2.0

config AON_WDT_RTL87X2G
	bool "RTL87X2G AON Watchdog Timer driver"
	default y
	depends on DT_HAS_REALTEK_RTL87X2G_AON_WDT_ENABLED
	select USE_HAL_REALTEK_AON_WDT
	help
	  Enable the RTL87X2G aon wdg timer driver.

config CORE_WDT_RTL87X2G
	bool "RTL87X2G Core Watchdog Timer driver"
	default y
	depends on DT_HAS_REALTEK_RTL87X2G_CORE_WDT_ENABLED
	select USE_HAL_REALTEK_CORE_WDT
	help
	  Enable the RTL87X2G core wdg timer driver.
```

## dts/bindings/adc/realtek,rtl87x2g-adc.yaml
```yaml
# Copyright(c) 2020, Realtek Semiconductor Corporation.
# SPDX-License-Identifier: Apache-2.0

description: |
  rtl87x2g ADC.

compatible: "realtek,rtl87x2g-adc"

include: [adc-controller.yaml, reset-device.yaml, pinctrl-device.yaml]

properties:
  reg:
    required: true

  clocks:
    required: true

#  resets:
#    required: true

  channels:
    type: int
    description: Number of external channels
    required: true

  interrupts:
    required: true

  "#io-channel-cells":
    const: 1

  pinctrl-0:
    required: true

  pinctrl-names:
    required: true

io-channel-cells:
  - input
```

## dts/bindings/bluetooth/realtek,bee-bt-hci.yaml
```yaml
description: Bluetooth HCI for Realtek Bee SoCs

compatible: "realtek,bee-bt-hci"

include: bt-hci.yaml

properties:
  bt-hci-name:
    default: "BT BEE"
  bt-hci-bus:
    default: "virtual"
```

## dts/bindings/clock/realtek,rtl8752h-cctl.yaml
```yaml
# Copyright(c) 2024, Realtek Semiconductor Corporation.
# SPDX-License-Identifier: Apache-2.0

description: |
  RTL8752H clock unit for all SoC peripherals in charge of
  clock control (CCTL). This binding represents the clock controller (CCTL).

  To specify the clocks in a peripheral, the standard clocks property needs
  to be used, e.g.:

    gpio: gpio@xxx {
        ...
        /* cell encodes related clock bit for specificed peripheral */
        clocks = <&cctl APB_CLK(GPIO)>;
        ...
    }

  Predefined clock cells are available in
  include/zephyr/dts-bindings/clock/rtl8752h-clocks.h header files.

compatible: "realtek,rtl8752h-cctl"

include: [clock-controller.yaml, base.yaml]

properties:
  "#clock-cells":
    const: 1

clock-cells:
  - id
```

## dts/bindings/clock/realtek,rtl87x2g-cctl.yaml
```yaml
# Copyright(c) 2020, Realtek Semiconductor Corporation.
# SPDX-License-Identifier: Apache-2.0

description: |
  RTL87X2G clock unit for all SoC peripherals in charge of
  clock control (CCTL). This binding represents the clock controller (CCTL).

  To specify the clocks in a peripheral, the standard clocks property needs
  to be used, e.g.:

    gpioa: gpio@xxx {
        ...
        /* cell encodes related clock bit for specificed peripheral */
        clocks = <&cctl APB_CLK(GPIOA)>;
        ...
    }

  Predefined clock cells are available in
  include/zephyr/dts-bindings/clock/rtl87x2g-clocks.h header files.

compatible: "realtek,rtl87x2g-cctl"

include: [clock-controller.yaml, base.yaml]

properties:
  "#clock-cells":
    const: 1

clock-cells:
  - id
```

## dts/bindings/counter/realtek,rtl8752h_rtc.yaml
```yaml
# Copyright(c) 2020, Realtek Semiconductor Corporation.
# SPDX-License-Identifier: Apache-2.0

description: |
        RTL8752H COUNTER RTC.

        From the above, setting 'status' is required while the prescaler is
        optional. Check below for more information on the prescaler.

compatible: "realtek,rtl8752h-rtc"

include: base.yaml

properties:
  reg:
    required: true

  interrupts:
    required: true

  channels:
    required: true
    type:
      int

  prescaler:
    description: |
      The prescaler value defines the factor by which the clock will be
      divided. The outcome of which serves as clock reference to the Timer
      itself.

    type: int
    default: 1
```

## dts/bindings/counter/realtek,rtl8752h_timer.yaml
```yaml
# Copyright(c) 2020, Realtek Semiconductor Corporation.
# SPDX-License-Identifier: Apache-2.0

description: |
        RTL8752H COUNTER TIMER.
        Each Timer is part of a Timer Group and the number of available Timers
        is SoC-dependent. RTL8752H has 12 Timers available, 8 normal timer and
        4 advanced timer.

        In order to use one of the available timers on your application add
        a <board>.overlay file with contents as below

          &timer2 {
                  status = "okay";
                  prescaler = <1>;
          };

        From the above, setting 'status' is required while the prescaler is
        optional. Check below for more information on the prescaler.

compatible: "realtek,rtl8752h-timer"

include: base.yaml

properties:
  reg:
    required: true

  interrupts:
    required: true

  clocks:
    required: true

  channels:
    required: true
    type:
      int

  is-enhanced:
    type:
      boolean

  prescaler:
    description: |
      The prescaler value defines the factor by which the clock will be
      divided. The outcome of which serves as clock reference to the Timer
      itself.

    type: int
    default: 1
    enum:
      - 1
      - 2
      - 4
      - 8
      - 16
      - 32
      - 40
      - 64
```

## dts/bindings/dma/realtek,rtl87x2g-dma-base.yaml
```yaml
# Copyright(c) 2020, Realtek Semiconductor Corporation.
# SPDX-License-Identifier: Apache-2.0

include: dma-controller.yaml

properties:
  reg:
    required: true

  interrupts:
    required: true

  dma-channels:
    required: true

  clocks:
    required: true

  dma-port:
    type: int
    required: true
```
