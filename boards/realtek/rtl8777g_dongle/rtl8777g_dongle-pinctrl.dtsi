/*
 * Copyright (c) 2025 Realtek Semiconductor Corp.
 *
 * SPDX-License-Identifier: Apache-2.0
 */

#include <dt-bindings/pinctrl/rtl87x2g-pinctrl.h>

&pinctrl {
	uart2_default: uart2_default {
		group1 {
			psels = <BEE_PSEL(UART2_TX, P3_0, DIR_OUT, DRV_HIGH, PULL_UP)>,
			        <BEE_PSEL(UART2_RX, P3_1, DIR_IN, DRV_HIGH, PULL_UP)>;
		};
	};
};
