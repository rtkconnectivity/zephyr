/*
 * Copyright(c) 2025, Realtek Semiconductor Corporation.
 * SPDX-License-Identifier: Apache-2.0
 */

#include <dt-bindings/pinctrl/rtl8752h-pinctrl.h>

&pinctrl {
	uart2_default: uart2_default {
		group1 {
			psels = <BEE_PSEL(UART2_TX, P2_3, DIR_OUT, DRV_HIGH, PULL_UP)>,
			<BEE_PSEL(UART2_RX, P2_4, DIR_IN, DRV_HIGH, PULL_UP)>;
		};
	};
};
