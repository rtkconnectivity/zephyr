## boards/realtek/rtl8752h_dongle/Kconfig.rtl8752h_dongle
```kconfig
# Copyright (c) 2025 Realtek Semiconductor Corp.
# SPDX-License-Identifier: Apache-2.0

config BOARD_RTL8752H_DONGLE
	select SOC_RTL8752HKF
```

## boards/realtek/rtl8752h_dongle/rtl8752h_dongle_defconfig
```kconfig
# Copyright (c) 2025 Realtek Semiconductor Corp.
# SPDX-License-Identifier: Apache-2.0

# DISASSEMBLY
CONFIG_OUTPUT_DISASSEMBLY=y

# link application into the flash partition selected by the zephyr,code-partition property in /chosen in devicetree
CONFIG_USE_DT_CODE_PARTITION=y
CONFIG_CODE_DATA_RELOCATION=y
CONFIG_REALTEK_BT_CONTROLLER_STACK_SIZE=2560

# For Debug
CONFIG_DEBUG_OPTIMIZATIONS=y
CONFIG_SYS_HEAP_RUNTIME_STATS=y
CONFIG_DEBUG_THREAD_INFO=y
CONFIG_THREAD_MONITOR=y
CONFIG_THREAD_STACK_INFO=y

# Console Driver
CONFIG_CONSOLE=y
CONFIG_UART_CONSOLE=y

# UART Driver
CONFIG_SERIAL=y
CONFIG_UART_INTERRUPT_DRIVEN=y
# CONFIG_UART_ASYNC_API=y

# Device init priority
CONFIG_CLOCK_CONTROL_INIT_PRIORITY=0
CONFIG_DMA_INIT_PRIORITY=1
CONFIG_SERIAL_INIT_PRIORITY=2

# Logging
CONFIG_LOG=y
CONFIG_LOG_BACKEND_SHOW_COLOR=n
CONFIG_LOG_FUNC_NAME_PREFIX_INF=y
CONFIG_LOG_FUNC_NAME_PREFIX_WRN=y
CONFIG_LOG_FUNC_NAME_PREFIX_ERR=y
```

## boards/realtek/rtl8752h_evb/Kconfig.defconfig
```kconfig
# Copyright (c) 2024 Realtek Semiconductor Corp.
# SPDX-License-Identifier: Apache-2.0
if BOARD_RTL8752H_EVB

config BOARD
	default "rtl8752h_evb"
endif

if BT
config NUM_METAIRQ_PRIORITIES
	default 1

config MAIN_STACK_SIZE
	default 2048

config COMMON_LIBC_MALLOC_ARENA_SIZE
	default 1024

config BT_CTLR
	default n

config REALTEK_BT
	default y

config BT_L2CAP_TX_MTU
	default 247

config BT_BUF_EVT_RX_COUNT
	default 8

config BT_BUF_EVT_RX_SIZE
	default 255

config BT_BUF_ACL_TX_SIZE
	default 251

config BT_BUF_ACL_RX_SIZE
	default 255

config BT_BUF_ACL_RX_COUNT
	default 7

config REALTEK_BT_CONTROLLER_STACK_SIZE
	default 2560
endif # BT
```

## boards/realtek/rtl8777g_dongle/Kconfig.defconfig
```kconfig
# Copyright (c) 2026, Realtek Semiconductor Corporation
# SPDX-License-Identifier: Apache-2.0

if BOARD_RTL8777G_DONGLE

config HW_STACK_PROTECTION
	default ARCH_HAS_STACK_PROTECTION

endif # BOARD_RTL8777G_DONGLE
```

## boards/realtek/rtl8777g_dongle/Kconfig.rtl8777g_dongle
```kconfig
# Copyright (c) 2025 Realtek Semiconductor Corp.
# SPDX-License-Identifier: Apache-2.0
config BOARD_RTL8777G_DONGLE
	select SOC_RTL8777G
```

## boards/realtek/rtl8777g_evb/Kconfig.rtl8777g_evb
```kconfig
# Copyright (c) 2026, Realtek Semiconductor Corporation
# SPDX-License-Identifier: Apache-2.0

config BOARD_RTL8777G_EVB
	select SOC_RTL8777GKF_VA5
```

## boards/realtek/rtl8777g_evb/board.yml
```yaml
board:
  name: rtl8777g_evb
  full_name: RTL8777G Dongle Evaluation Board
  vendor: realtek
  socs:
    - name: rtl8777gkf_va5
```

## boards/realtek/rtl87x2g_evb/rtl87x2g_evb_defconfig
```kconfig
# Console Driver
CONFIG_CONSOLE=y
CONFIG_UART_CONSOLE=y

# UART Driver
CONFIG_SERIAL=y
CONFIG_UART_INTERRUPT_DRIVEN=y
# CONFIG_UART_ASYNC_API=y

# Device init priority
CONFIG_CLOCK_CONTROL_INIT_PRIORITY=0
CONFIG_DMA_INIT_PRIORITY=1
CONFIG_SERIAL_INIT_PRIORITY=2

# Build a secure image by default
CONFIG_TRUSTED_EXECUTION_SECURE=y
CONFIG_ARM_SECURE_BUSFAULT_HARDFAULT_NMI=y

# DISASSEMBLY
CONFIG_OUTPUT_DISASSEMBLY=y

# Enable HW stack protection
CONFIG_HW_STACK_PROTECTION=y
```

## boards/realtek/rtl87x2j_evb/Kconfig.defconfig
```kconfig
# Copyright (c) 2026, Realtek Semiconductor Corp.
# SPDX-License-Identifier: Apache-2.0

if BOARD_RTL87X2J_EVB

config HW_STACK_PROTECTION
	default ARCH_HAS_STACK_PROTECTION

endif # BOARD_RTL87X2J_EVB
```

## boards/realtek/rtl87x2j_evb/Kconfig.rtl87x2j_evb
```kconfig
# Copyright (c) 2026, Realtek Semiconductor Corp.
# SPDX-License-Identifier: Apache-2.0

config BOARD_RTL87X2J_EVB
	select SOC_RTL8762JTH if BOARD_RTL87X2J_EVB_RTL8762JTH
```

## boards/realtek/rtl87x2j_evb/board.yml
```yaml
board:
  name: rtl87x2j_evb
  full_name: RTL87x2J Evaluation Board
  vendor: realtek
  socs:
    - name: rtl8762jth
```

## boards/realtek/rtl87x2j_evb/rtl87x2j_evb_rtl8762jth_defconfig
```kconfig
# Copyright (c) 2026, Realtek Semiconductor Corp.
# SPDX-License-Identifier: Apache-2.0

#DISASSEMBLY
CONFIG_OUTPUT_DISASSEMBLY=y

# Console Driver
CONFIG_CONSOLE=y
CONFIG_UART_CONSOLE=y

# UART Driver
CONFIG_SERIAL=y
CONFIG_UART_INTERRUPT_DRIVEN=y

CONFIG_OUTPUT_DISASSEMBLY=y
```

## drivers/adc/Kconfig.bee
```kconfig
# Copyright (c) 2026 Realtek Semiconductor Corp.
# SPDX-License-Identifier: Apache-2.0

config ADC_BEE
	bool "ADC controller driver for Realtek Bee series SoC"
	default y
	depends on DT_HAS_REALTEK_BEE_ADC_ENABLED
	select USE_HAL_REALTEK_ADC
	help
	  This option enables the ADC driver for Realtek Bee SoCs.
```

## drivers/audio/Kconfig.bee
```kconfig
# Copyright (c) 2026, Realtek Semiconductor Corporation.
# SPDX-License-Identifier: Apache-2.0

config AUDIO_CODEC_BEE
	bool "BEE family Audio Codec driver"
	default y
	depends on DT_HAS_REALTEK_BEE_CODEC_ENABLED
	select I2S
	select HAL_REALTEK_BEE_CODEC
	help
	  Enable Audio Codec driver for Realtek BEE family SoCs (rtl8752h, rtl87x2g, rtl87x2j).
```

## drivers/audio/Kconfig.rtl8752h
```kconfig
# RTL8752H codec configuration

# Copyright(c) 2024, Realtek Semiconductor Corporation.
# SPDX-License-Identifier: Apache-2.0

config AUDIO_RTL8752H
	bool "RTL8752H MCU codec controller driver"
	default y
	depends on DT_HAS_REALTEK_RTL8752H_CODEC_ENABLED
	select I2S
	select USE_HAL_REALTEK_CODEC
	help
	  Enable the RTL8752H codec driver.
```

## drivers/audio/Kconfig.rtl87x2g
```kconfig
# RTL87X2G codec configuration

# Copyright(c) 2025, Realtek Semiconductor Corporation.
# SPDX-License-Identifier: Apache-2.0

config AUDIO_RTL87X2G
	bool "RTL87X2G MCU codec controller driver"
	default y
	depends on DT_HAS_REALTEK_RTL87X2G_CODEC_ENABLED
	select I2S
	select USE_HAL_REALTEK_CODEC
	help
	  Enable the rtl87x2g codec driver.
```

## drivers/bluetooth/hci/Kconfig.bee
```kconfig
# Copyright (c) 2026, Realtek Semiconductor Corporation
# SPDX-License-Identifier: Apache-2.0

if SOC_FAMILY_REALTEK_BEE

config BT_BEE
	bool "Realtek Bee series BT HCI driver"
	default y
	depends on SOC_SERIES_RTL87X2G
	help
	  This option enables the bt hci driver for Realtek Bee SoCs.

if BT_BEE
config BT_RTK_HCI_H2C_POOL_SIZE
	int "HCI h2c pool size"
	default 3072
	help
		HCI H2C POOL is used by HCI command packets and
		HCI ACL data packets. Set this value according max
		LE ACL data packets num and max HCI command packets num.
endif # BT_BEE

endif
```

## drivers/clock_control/Kconfig.bee
```kconfig
# Copyright (c) 2026 Realtek Semiconductor Corp.
# SPDX-License-Identifier: Apache-2.0

config CLOCK_CONTROL_BEE
	bool "clock controller driver for Realtek Bee series SoC"
	default y
	depends on DT_HAS_REALTEK_BEE_CCTL_ENABLED
	select USE_HAL_REALTEK_RCC
	help
	  This option enables the clock controller driver for Realtek Bee SoCs.
```

## drivers/counter/Kconfig.bee_rtc
```kconfig
# BEE counter rtc configuration

# Copyright(c) 2025, Realtek Semiconductor Corporation.
# SPDX-License-Identifier: Apache-2.0

config COUNTER_RTC_BEE
	bool "BEE rtc counter driver"
	default y if !RTC_BEE
	depends on DT_HAS_REALTEK_BEE_RTC_ENABLED
	select USE_HAL_REALTEK_RTC
	help
	  Enable the bee counter rtc driver.
```

## drivers/counter/Kconfig.bee_timer
```kconfig
# BEE counter timer configuration

# Copyright(c) 2025, Realtek Semiconductor Corporation.
# SPDX-License-Identifier: Apache-2.0

config COUNTER_TIMER_BEE
	bool "BEE timer counter driver"
	default y
	depends on DT_HAS_REALTEK_BEE_TIMER_ENABLED
	select USE_HAL_REALTEK_TIM
	select USE_HAL_REALTEK_ENHTIM
	help
	  Enable the bee counter timer driver.
```

## drivers/dma/Kconfig.bee
```kconfig
# Copyright (c) 2026 Realtek Semiconductor Corp.
# SPDX-License-Identifier: Apache-2.0

config DMA_BEE
	bool "DMA driver for Realtek Bee series SoC"
	default y
	depends on DT_HAS_REALTEK_BEE_DMA_ENABLED
	select USE_HAL_REALTEK_DMA
	help
	  This option enables the DMA driver for Realtek Bee SoCs.
```

## drivers/flash/Kconfig.bee_eflash
```kconfig
# Copyright(c) 2026, Realtek Semiconductor Corporation.
# SPDX-License-Identifier: Apache-2.0

config SOC_FLASH_BEE_EFLASH
	bool "Realtek Bee eflash driver"
	default y
	depends on DT_HAS_REALTEK_BEE_EFLASH_CONTROLLER_ENABLED
	select FLASH_HAS_DRIVER_ENABLED
	select FLASH_HAS_PAGE_LAYOUT
	select FLASH_HAS_EXPLICIT_ERASE
	help
	  Enable Realtek Bee eflash driver.
```
