## boards/arm/rtl8752htv_evb/rtl8752htv_evb_defconfig
```kconfig
CONFIG_SOC_SERIES_RTL8752H=y
CONFIG_SOC_RTL8752HTV=y
CONFIG_BOARD_RTL8752HTV_EVB=y

# DISASSEMBLY
CONFIG_OUTPUT_DISASSEMBLY=y

# link application into the the flash partition selected by the zephyr,code-partition property in /chosen in devicetree
CONFIG_USE_DT_CODE_PARTITION=y
CONFIG_CODE_DATA_RELOCATION=y
CONFIG_REALTEK_BT_CONTROLLER_STACK_SIZE=2560
# Save DataRAM for APP


# For Debug
CONFIG_DEBUG_OPTIMIZATIONS=y
CONFIG_SYS_HEAP_RUNTIME_STATS=y

CONFIG_PINCTRL=y
CONFIG_CLOCK_CONTROL=y

# Console Driver
CONFIG_CONSOLE=y
CONFIG_UART_CONSOLE=y

# UART Driver
CONFIG_SERIAL=y
CONFIG_UART_INTERRUPT_DRIVEN=y
# CONFIG_UART_ASYNC_API=y

# power manager settings (default disabled)
CONFIG_PM=n
CONFIG_THREAD_STACK_INFO=y
CONFIG_PM_DEVICE=n
# CONFIG_PM_POLICY_CUSTOM=n # use zephyr pm flow, enable this config; use realtek pm flow, disable this config.
CONFIG_RUNTIME_NMI=y # customize NMI for Power Manager
CONFIG_TICKLESS_KERNEL=n
CONFIG_TIMESLICE_SIZE=10

CONFIG_DEBUG_THREAD_INFO=y
CONFIG_THREAD_MONITOR=y
CONFIG_IDLE_STACK_SIZE=512
```

## boards/arm/rtl8762gn_evb/Kconfig.defconfig
```kconfig
if BOARD_RTL8762GN_EVB

config BOARD
	default "rtl8762gn_evb"

endif #BOARD_RTL8762GN_EVB

if BT

choice BT_HCI_BUS_TYPE
	default BT_RTL87X2G
endchoice

choice BT_RECV_CONTEXT
	default BT_RECV_BLOCKING
endchoice

config BT_CTLR
	default n

config REALTEK_BT
	default y

config BT_L2CAP_TX_MTU
	default 247
	
config BT_BUF_EVT_RX_COUNT
	default 8

config BT_BUF_EVT_RX_SIZE
	default 255

config BT_BUF_ACL_TX_SIZE
	default 251

config BT_BUF_ACL_RX_SIZE
	default 255

config BT_BUF_ACL_RX_COUNT
	default 7

endif # BT
```

## boards/arm/rtl8762gn_evb/rtl8762gn_evb_defconfig
```kconfig
CONFIG_SOC_SERIES_RTL87X2G=y
CONFIG_SOC_RTL8762GN=y
CONFIG_BOARD_RTL8762GN_EVB=y

# Console Driver
CONFIG_CONSOLE=y
CONFIG_UART_CONSOLE=y

# UART Driver
CONFIG_SERIAL=y
CONFIG_UART_INTERRUPT_DRIVEN=y
# CONFIG_UART_ASYNC_API=y

# General Kernel Options
CONFIG_TICKLESS_KERNEL=n
CONFIG_TIMESLICE_SIZE=10
CONFIG_INIT_STACKS=y
CONFIG_FPU=y
CONFIG_XIP=y
CONFIG_CODE_DATA_RELOCATION=y #place vector table and ISR code to RAM to avoid hardfault triggered by flash-suspend
CONFIG_LINKER_USE_BOOT_SECTION=y

# trustzone related
CONFIG_TRUSTED_EXECUTION_NONSECURE=n
CONFIG_TRUSTED_EXECUTION_SECURE=y
CONFIG_ARM_SECURE_BUSFAULT_HARDFAULT_NMI=y

# DISASSEMBLY
CONFIG_OUTPUT_DISASSEMBLY=y

# flashing
# link application into the the flash partition selected by the zephyr,code-partition property in /chosen in devicetree
CONFIG_USE_DT_CODE_PARTITION=y

# power manager settings (default disabled)
# CONFIG_PM=y
# CONFIG_PM_DEVICE=y
# CONFIG_PM_POLICY_CUSTOM=n # use zephyr pm flow, enable this config; use realtek pm flow, disable this config.
# CONFIG_RUNTIME_NMI=y # customize NMI for Power Manager
# CONFIG_REALTEK_USING_SDK_LIB=y
```

## boards/realtek/rtl87x2g_evb/Kconfig.defconfig
```kconfig
# Copyright (c) 2024 Realtek Semiconductor Corp.
# SPDX-License-Identifier: Apache-2.0
if BOARD_RTL87X2G_EVB

config BOARD
	default "rtl87x2g_evb"

config SERIAL
	default y

config UART_INTERRUPT_DRIVEN
	default y

config CONSOLE
	default y

config UART_CONSOLE
	default CONSOLE

endif #BOARD_RTL87X2G_EVB
```

## drivers/adc/Kconfig.rtl8752h
```kconfig
# RTL8752H adc configuration

# Copyright(c) 2024, Realtek Semiconductor Corporation.
# SPDX-License-Identifier: Apache-2.0

config ADC_RTL8752H
	bool "RTL8752H MCU adc driver"
	default y
	depends on DT_HAS_REALTEK_RTL8752H_ADC_ENABLED
	select USE_HAL_REALTEK_ADC
	help
	  Enable the RTL8752H adc driver.
```

## drivers/adc/Kconfig.rtl87x2g
```kconfig
# RTL87X2G adc configuration

# Copyright(c) 2020, Realtek Semiconductor Corporation.
# SPDX-License-Identifier: Apache-2.0

config ADC_RTL87X2G
	bool "RTL87X2G MCU adc driver"
	default y
	depends on DT_HAS_REALTEK_RTL87X2G_ADC_ENABLED
	select USE_HAL_REALTEK_ADC
	help
	  Enable the RTL87X2G adc driver.
```

## drivers/bluetooth/hci/Kconfig.realtek
```kconfig
# Copyright(c) 2020, Realtek Semiconductor Corporation.
# SPDX-License-Identifier: Apache-2.0

if SOC_FAMILY_REALTEK_BEE

config BT_RTK_HCI_H2C_POOL_SIZE
	int "HCI h2c pool size"
	default 3072
	help
		HCI H2C POOL is used by HCI command packets and
		HCI ACL data packets. Set this value according max
		LE ACL data packets num and max HCI command packets num.

endif
```

## drivers/clock_control/Kconfig.rtl8752h
```kconfig
# RTL8752H clock control configuration

# Copyright(c) 2024, Realtek Semiconductor Corporation.
# SPDX-License-Identifier: Apache-2.0

config CLOCK_CONTROL_RTL8752H
	bool "RTL8752H clock control"
	default y
	depends on DT_HAS_REALTEK_RTL8752H_CCTL_ENABLED
	select USE_HAL_REALTEK_RCC
	help
	  Enable driver for RTL8752H Reset Clock Unit (RCU).
```

## drivers/clock_control/Kconfig.rtl87x2g
```kconfig
# RTL87X2G clock control configuration

# Copyright(c) 2020, Realtek Semiconductor Corporation.
# SPDX-License-Identifier: Apache-2.0

config CLOCK_CONTROL_RTL87X2G
	bool "RTL87X2G clock control"
	default y
	depends on DT_HAS_REALTEK_RTL87X2G_CCTL_ENABLED
	select USE_HAL_REALTEK_RCC
	help
	  Enable driver for RTL87X2G Reset Clock Unit (RCU).
```

## drivers/counter/Kconfig.rtl8752h_rtc
```kconfig
# RTL8752H counter rtc configuration

# Copyright(c) 2020, Realtek Semiconductor Corporation.
# SPDX-License-Identifier: Apache-2.0

config COUNTER_RTC_RTL8752H
	bool "RTL8752H rtc counter driver"
	default y
	depends on DT_HAS_REALTEK_RTL8752H_RTC_ENABLED
	select USE_HAL_REALTEK_RTC
	help
	  Enable the RTL8752H counter rtc driver.
```

## drivers/counter/Kconfig.rtl8752h_timer
```kconfig
# RTL8752H counter timer configuration

# Copyright(c) 2020, Realtek Semiconductor Corporation.
# SPDX-License-Identifier: Apache-2.0

config COUNTER_TIMER_RTL8752H
	bool "RTL8752H timer counter driver"
	default y
	depends on DT_HAS_REALTEK_RTL8752H_TIMER_ENABLED
	select USE_HAL_REALTEK_TIM
	select USE_HAL_REALTEK_ENHTIM
	help
	  Enable the RTL8752H counter timer driver.
```

## drivers/counter/Kconfig.rtl87x2g_rtc
```kconfig
# RTL87X2G counter rtc configuration

# Copyright(c) 2020, Realtek Semiconductor Corporation.
# SPDX-License-Identifier: Apache-2.0

config COUNTER_RTC_RTL87X2G
	bool "RTL87X2G rtc counter driver"
	default y
	depends on DT_HAS_REALTEK_RTL87X2G_RTC_ENABLED
	select USE_HAL_REALTEK_RTC
	help
	  Enable the RTL87X2G counter rtc driver.
```

## drivers/counter/Kconfig.rtl87x2g_timer
```kconfig
# RTL87X2G counter timer configuration

# Copyright(c) 2020, Realtek Semiconductor Corporation.
# SPDX-License-Identifier: Apache-2.0

config COUNTER_TIMER_RTL87X2G
	bool "RTL87X2G timer counter driver"
	default y
	depends on DT_HAS_REALTEK_RTL87X2G_TIMER_ENABLED
	select USE_HAL_REALTEK_TIM
	select USE_HAL_REALTEK_ENHTIM
	help
	  Enable the RTL87X2G counter timer driver.
```

## drivers/dma/Kconfig.rtl8752h
```kconfig
# RTL8752H dma configuration

# Copyright(c) 2020, Realtek Semiconductor Corporation.
# SPDX-License-Identifier: Apache-2.0

config DMA_RTL8752H
	bool "RTL8752H MCU DMA driver"
	default y
	depends on DT_HAS_REALTEK_RTL8752H_DMA_ENABLED
	select USE_HAL_REALTEK_DMA
	help
	  Enable the RTL8752H dma driver.
```

## drivers/dma/Kconfig.rtl87x2g
```kconfig
# RTL87X2G dma configuration

# Copyright(c) 2020, Realtek Semiconductor Corporation.
# SPDX-License-Identifier: Apache-2.0

config DMA_RTL87X2G
	bool "RTL87X2G MCU DMA driver"
	default y
	depends on DT_HAS_REALTEK_RTL87X2G_DMA_ENABLED
	select USE_HAL_REALTEK_DMA
	help
	  Enable the RTL87X2G dma driver.
```

## drivers/entropy/Kconfig.rtl8752h
```kconfig
# RTL8752H wdt configuration

# Copyright(c) 2020, Realtek Semiconductor Corporation.
# SPDX-License-Identifier: Apache-2.0

config ENTROPY_RTL8752H_TRNG
	bool "RTL8752H trng driver"
	default y
	depends on DT_HAS_REALTEK_RTL8752H_TRNG_ENABLED
	select ENTROPY_HAS_DRIVER
	help
	  Enable the RTL8752H trng driver.
```

## drivers/entropy/Kconfig.rtl87x2g
```kconfig
# RTL87X2G wdt configuration

# Copyright(c) 2020, Realtek Semiconductor Corporation.
# SPDX-License-Identifier: Apache-2.0

config ENTROPY_RTL87X2G_TRNG
	bool "RTL87X2G trng driver"
	default y
	depends on DT_HAS_REALTEK_RTL87X2G_TRNG_ENABLED
	select ENTROPY_HAS_DRIVER
	help
	  Enable the RTL87X2G trng driver.
```

## drivers/flash/Kconfig.rtl8752h
```kconfig
# RTL8752H FLASH configuration

# Copyright(c) 2020, Realtek Semiconductor Corporation.
# SPDX-License-Identifier: Apache-2.0

config SOC_FLASH_RTL8752H
	bool "Realtek RTL8752H flash driver"
	default y
	depends on DT_HAS_REALTEK_RTL8752H_FLASH_CONTROLLER_ENABLED
	select FLASH_HAS_DRIVER_ENABLED
	select FLASH_HAS_PAGE_LAYOUT
	help
	  Enable rtl8752h flash driver.

if SOC_FLASH_RTL8752H

choice
	prompt "Realtek RTL8752H Flash Mode"
	default SOC_FLASH_RTL8752H_4BIT_MODE

config SOC_FLASH_RTL8752H_1BIT_MODE
	bool "Flash 1bit mode"
	help
		Set Realtek RTL8752H Flash to 1bit mode

config SOC_FLASH_RTL8752H_2BIT_MODE
	bool "Flash 2bit mode"
	help
		Set Realtek RTL8752H Flash to 2bit mode

config SOC_FLASH_RTL8752H_4BIT_MODE
	bool "Flash 4bit mode"
	help
		Set Realtek RTL8752H Flash to 4bit mode

endchoice

config SOC_FLASH_RTL8752H_BIT_MODE
	int
	default 0 if SOC_FLASH_RTL8752H_1BIT_MODE
	default 1 if SOC_FLASH_RTL8752H_2BIT_MODE
	default 2 if SOC_FLASH_RTL8752H_4BIT_MODE

endif # SOC_FLASH_RTL8752H
```

## drivers/gpio/Kconfig.rtl8752h
```kconfig
# RTL8752H gpio configuration

# Copyright(c) 2024, Realtek Semiconductor Corporation.
# SPDX-License-Identifier: Apache-2.0

menuconfig GPIO_RTL8752H
	bool "RTL8752H MCU GPIO driver"
	default y
	select USE_HAL_REALTEK_GPIO
	select DYNAMIC_INTERRUPTS
	depends on DT_HAS_REALTEK_RTL8752H_GPIO_ENABLED
	help
	  Enable the RTL8752H gpio driver.

if GPIO_RTL8752H

config RTL8752H_USE_P4_1_AS_GPIO29
	bool "Use P4_1 as GPIO29 on RTL8752H"
	default n
	help
	  If true, use P4_1 as GPIO29 on RTL8752H, else use P3_5.

config RTL8752H_USE_P4_2_AS_GPIO30
	bool "Use P4_2 as GPIO30 on RTL8752H"
	default n
	help
	  If true, use P4_2 as GPIO30 on RTL8752H, else use P3_6.

endif # GPIO_RTL8752H
```

## drivers/gpio/Kconfig.rtl87x2g
```kconfig
# RTL87X2G gpio configuration

# Copyright(c) 2020, Realtek Semiconductor Corporation.
# SPDX-License-Identifier: Apache-2.0

menuconfig GPIO_RTL87X2G
	bool "RTL87X2G MCU GPIO driver"
	default y
	select USE_HAL_REALTEK_GPIO
	depends on DT_HAS_REALTEK_RTL87X2G_GPIO_ENABLED
	help
	  Enable the RTL87X2G gpio driver.

if GPIO_RTL87X2G && (SOC_RTL8762GTU || SOC_RTL8762GTH)

config RTL87X2G_USE_P6_2_AS_GPIOB21
	bool "Use P6_2 as GPIOB_21 on RTL8762GTU or RTL8762GTH"
	default n
	help
	  If true, use P6_2 as GPIOB_21 on RTL8762GTU or RTL8762GTH, else use P9_0.

config RTL87X2G_USE_P6_3_AS_GPIOB22
	bool "Use P6_3 as GPIOB_22 on RTL8762GTU or RTL8762GTH"
	default n
	help
	  If true, use P6_3 as GPIOB_22 on RTL8762GTU or RTL8762GTH, else use P9_1.

config RTL87X2G_USE_P6_5_AS_GPIOB24
	bool "Use P6_5 as GPIOB_24 on RTL8762GTU or RTL8762GTH"
	default n
	help
	  If true, use P6_5 as GPIOB_24 on RTL8762GTU or RTL8762GTH, else use P9_3.

config RTL87X2G_USE_P6_7_AS_GPIOB26
	bool "Use P6_7 as GPIOB_26 on RTL8762GTU or RTL8762GTH"
	default n
	help
	  If true, use P6_7 as GPIOB_26 on RTL8762GTU or RTL8762GTH, else use P9_5.

endif # GPIO_RTL87X2G && (SOC_RTL8762GTU || SOC_RTL8762GTH)
```

## drivers/i2c/Kconfig.rtl87x2g
```kconfig
# RTL87X2G i2c configuration

# Copyright(c) 2020, Realtek Semiconductor Corporation.
# SPDX-License-Identifier: Apache-2.0

config I2C_RTL87X2G
	bool "RTL87X2G I2C driver"
	default y
	depends on DT_HAS_REALTEK_RTL87X2G_I2C_ENABLED
	select USE_HAL_REALTEK_I2C
	help
	  Enable the RTL87X2G i2c driver.
```

## drivers/ieee802154/Kconfig.rtl87x2g
```kconfig
config IEEE802154_RTL87X2G
	bool "rtl87x2g series IEEE 802.15.4 Driver"
	default y
	depends on DT_HAS_REALTEK_RTL87X2G_IEEE802154_ENABLED
```
