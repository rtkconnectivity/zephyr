## soc/arm/realtek_bee/Kconfig
```kconfig
config SOC_FAMILY_REALTEK_BEE
	bool
	# select HAS_SEGGER_RTT
	select BUILD_OUTPUT_HEX

if SOC_FAMILY_REALTEK_BEE
config SOC_FAMILY
	string
	default "realtek_bee"

rsource "*/Kconfig.soc"

config SYSTICK_USE_EXTERNAL_CLOCK
	bool "systick use external clock"

config SYSTICK_USE_CPU_CLOCK
	bool "systick use cpu clock"

config REALTEK_IMAGE_HEADER
    bool
	default y
	help
	  This config will prepend realtek_image_header on the zephyr binary.

endif # SOC_FAMILY_REALTEK_BEE
```

## soc/arm/realtek_bee/Kconfig.defconfig
```kconfig
if SOC_FAMILY_REALTEK_BEE

if REALTEK_OTA
config COMMON_LIBC_MALLOC_ARENA_SIZE
	default 8192
endif

rsource "*/Kconfig.defconfig.series"

endif
```

## soc/arm/realtek_bee/rtl8752h/Kconfig.defconfig.series
```kconfig
if SOC_SERIES_RTL8752H

config SOC_SERIES
	default "rtl8752h"

config SOC_PART_NUMBER
	default "rtl8752HTV" if SOC_PART_NUMBER_RTL8752HTV

# specifies the frequency of the hardware timer used for the system clock (in Hz)
config SYS_CLOCK_HW_CYCLES_PER_SEC
	int
	default 40000000

config NUM_IRQS
	int
	default 64

config CORTEX_M_SYSTICK
	default y

config SYS_CLOCK_TICKS_PER_SEC
	int
	default 100
	#1s = 100 ticks

# config ARCH_HAS_CUSTOM_BUSY_WAIT
# 	default y

# config IDLE_STACK_SIZE
#     default 1024

# config NUM_METAIRQ_PRIORITIES
# 	default 1

rsource "Kconfig.defconfig.rtl87*"

endif # SOC_SERIES_RTL8752H
```

## soc/arm/realtek_bee/rtl8752h/Kconfig.series
```kconfig
config SOC_SERIES_RTL8752H
	bool "RTL8752H Series MCU"
	select ARM
	select CPU_CORTEX_M0PLUS
	select SOC_FAMILY_REALTEK_BEE
	select PLATFORM_SPECIFIC_INIT
	select CPU_CORTEX_M_HAS_VTOR
	select CPU_CORTEX_M_HAS_SYSTICK
	help
	  Enable support for RTL8725H MCU series
```

## soc/arm/realtek_bee/rtl8752h/Kconfig.soc
```kconfig
choice
	prompt "RealTek RTL8752H MCU Selection"
	depends on SOC_SERIES_RTL8752H

config SOC_RTL8752HTV
	bool "SOC_RTL8752HTV"


endchoice

if SOC_SERIES_RTL8752H

config SOC_PART_NUMBER_RTL8752HTV
	bool

endif
```

## soc/arm/realtek_bee/rtl87x2g/Kconfig.defconfig.series
```kconfig
if SOC_SERIES_RTL87X2G

config SOC_SERIES
	default "rtl87x2g"

config SOC_PART_NUMBER
	default "rtl8772gwp" if SOC_PART_NUMBER_RTL8772GWP
	default "rtl8762gn" if SOC_PART_NUMBER_RTL8762GN

config NUM_IRQS
	int
	default 109

config SYS_CLOCK_TICKS_PER_SEC
	int
	default 100
    #10ms/1tick

config IDLE_STACK_SIZE
    default 1024

rsource "Kconfig.defconfig.rtl8762gn"

endif # SOC_SERIES_RTL87X2G
```

## soc/arm/realtek_bee/rtl87x2g/Kconfig.series
```kconfig
config SOC_SERIES_RTL87X2G
	bool "RTL87X2G Series MCU"
	select ARM
	select CPU_CORTEX_M55
	select CPU_HAS_ARM_SAU
	select CPU_HAS_FPU
	select CPU_HAS_ARM_MPU
	select ARMV8_M_DSP
	select ARMV8_1_M_MVEI
	select ARMV8_1_M_MVEF
	select SOC_FAMILY_REALTEK_BEE
	select ARM_TRUSTZONE_M
	select SHARED_MULTI_HEAP
	select SYSTICK_USE_EXTERNAL_CLOCK
	select HAS_PM
	select THREAD_STACK_INFO
```

## soc/arm/realtek_bee/rtl87x2g/Kconfig.soc
```kconfig
choice
	prompt "RealTek RTL87x2G MCU Selection"
	depends on SOC_SERIES_RTL87X2G

config SOC_RTL8762GKU
	bool "SOC_RTL8762GKU"

config SOC_RTL8762GN
	bool "SOC_RTL8762GN"

config SOC_RTL8762GTP
	bool "SOC_RTL8762GTP"

config SOC_RTL8762GTU
	bool "SOC_RTL8762GTU"

config SOC_RTL8772GWF
	bool "SOC_RTL8772GWF"

config SOC_RTL8772GWP
	bool "SOC_RTL8772GWP"

config SOC_RTL8777G
	bool "SOC_RTL8777G"

endchoice

if SOC_SERIES_RTL87X2G

config SOC_PART_NUMBER_RTL8762GKU
	bool
config SOC_PART_NUMBER_RTL8762GN
	bool
config SOC_PART_NUMBER_RTL8762GTP
	bool
config SOC_PART_NUMBER_RTL8762GTU
	bool
config SOC_PART_NUMBER_RTL8772GWF
	bool
config SOC_PART_NUMBER_RTL8772GWP
	bool
config SOC_PART_NUMBER_RTL8777G
	bool

endif
```

## soc/arm/rtk_bee/Kconfig
```kconfig
config SOC_FAMILY_RTK_BEE
	bool
	# select HAS_SEGGER_RTT
	select BUILD_OUTPUT_HEX

if SOC_FAMILY_RTK_BEE
config SOC_FAMILY
	string
	default "rtk_bee"

rsource "*/Kconfig.soc"

config SYSTICK_USE_EXTERNAL_CLOCK
	bool "systick use external clock"

config SYSTICK_USE_CPU_CLOCK
	bool "systick use cpu clock"

config RTK_IMAGE_HEADER
    bool
	default y
	help
	  This config will prepend rtk_image_header on the zephyr binary.

endif # SOC_FAMILY_RTK_BEE
```

## soc/arm/rtk_bee/rtl87x2g/Kconfig.defconfig.rtl8762gn
```kconfig
config SYS_CLOCK_HW_CYCLES_PER_SEC
	int
	default 32000 if SYSTICK_USE_EXTERNAL_CLOCK
    default 40000000 if SYSTICK_USE_CPU_CLOCK
```

## soc/arm/rtk_bee/rtl87x2g/Kconfig.series
```kconfig
config SOC_SERIES_RTL87X2G
	bool "RTL87X2G Series MCU"
	select ARM
	select CPU_CORTEX_M55
	select CPU_HAS_ARM_SAU
	select CPU_HAS_FPU
	# select CPU_HAS_ARM_MPU
	select SOC_FAMILY_RTK_BEE
	select ARM_TRUSTZONE_M
	select SHARED_MULTI_HEAP
	select SYSTICK_USE_EXTERNAL_CLOCK
```

## soc/realtek/bee/Kconfig.defconfig
```kconfig
# Copyright (c) 2024 Realtek Semiconductor Corp.
# SPDX-License-Identifier: Apache-2.0
if SOC_FAMILY_REALTEK_BEE

rsource "*/Kconfig.defconfig.series"

config PINCTRL
	default y

# config RESET
# 	default y

config CLOCK_CONTROL
	default y

endif
```

## soc/realtek/bee/Kconfig.soc
```kconfig
# Copyright (c) 2024 Realtek Semiconductor Corp.
# SPDX-License-Identifier: Apache-2.0
config SOC_FAMILY_REALTEK_BEE
	bool

config SOC_FAMILY
	default "realtek_bee" if SOC_FAMILY_REALTEK_BEE

rsource "*/Kconfig.soc"
```
