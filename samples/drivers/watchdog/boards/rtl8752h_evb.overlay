/*
 * Copyright (c) 2025 Realtek Semiconductor Corp.
 *
 * SPDX-License-Identifier: Apache-2.0
 */

/ {
	aliases {
		watchdog0 = &aonwdt;
	};
};

&corewdt {
	status = "disabled";
	div-factor = <63>;
};

&aonwdt {
	status = "okay";
};
